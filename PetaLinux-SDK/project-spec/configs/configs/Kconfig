## PetaLinux-SDK/project-spec/configs/configs/Kconfig
```kconfig
mainmenu "PetaLinux System Configuration"
config SUBSYSTEM_TYPE_LINUX
        bool
        default y
        select SYSTEM_ZYNQ

config SYSTEM_ZYNQ
        bool "ZYNQ Configuration"
        help
          ZYNQ Configuration for the project.
          All these config options will be in /home/lanza/workspace/PetaLinux-to-EDF-Demo/PetaLinux-SDK/project-spec/configs/config

config SUBSYSTEM_SDT_FLOW
        bool
        default y
        help

config SUBSYSTEM_DISTRO_PETALINUX
        bool
        default y
        help

source /home/lanza/workspace/PetaLinux-to-EDF-Demo/PetaLinux-SDK/project-spec/configs/configs/Kconfig.main
```

## PetaLinux-SDK/project-spec/configs/configs/Kconfig.main
```kconfig
# Copyright (C) 2021-2022, Xilinx, Inc.  All rights reserved.
# Copyright (C) 2022-2024, Advanced Micro Devices, Inc.  All rights reserved.
#
# SPDX-License-Identifier: MIT
#

choice
	prompt "Subsystem Architecture (NO EDIT!)"
	default SUBSYSTEM_ARCH_ARM
	help
	  This option is to control the processor targeted by System Configuration.
	  WARNING: Do not edit this option.

config SUBSYSTEM_ARCH_AARCH64
	bool "aarch64"
	help
	  Choose this option to specify AARCH64 as the SUBSYSTEM architecture

config SUBSYSTEM_ARCH_ARM
	bool "arm"
	help
	  Choose this option to specify ARM as the SUBSYSTEM architecture

config SUBSYSTEM_ARCH_MICROBLAZE
	bool "microblaze"
	help
	  Choose this option to specify MicroBlaze as the SUBSYSTEM architecture
endchoice

config SUBSYSTEM_ENDIAN_LITTLE
	bool
	default y

if SUBSYSTEM_SDT_FLOW

source /home/lanza/workspace/PetaLinux-to-EDF-Demo/PetaLinux-SDK/project-spec/configs/configs/Kconfig.bootcompselection

endif

if SUBSYSTEM_DISTRO_PETALINUX

source /home/lanza/workspace/PetaLinux-to-EDF-Demo/PetaLinux-SDK/project-spec/configs/configs/Kconfig.linuxcompselection

source /home/lanza/workspace/PetaLinux-to-EDF-Demo/PetaLinux-SDK/project-spec/configs/configs/Kconfig.autoconfigsettings

endif

source /home/lanza/workspace/PetaLinux-to-EDF-Demo/PetaLinux-SDK/project-spec/configs/configs/Kconfig.syshw

source /home/lanza/workspace/PetaLinux-to-EDF-Demo/PetaLinux-SDK/project-spec/configs/configs/Kconfig.dtgsettings

source /home/lanza/workspace/PetaLinux-to-EDF-Demo/PetaLinux-SDK/project-spec/configs/configs/Kconfig.bootcompconfigurations

if SUBSYSTEM_DISTRO_PETALINUX

source /home/lanza/workspace/PetaLinux-to-EDF-Demo/PetaLinux-SDK/project-spec/configs/configs/Kconfig.imagepkgconfigurations

endif

source /home/lanza/workspace/PetaLinux-to-EDF-Demo/PetaLinux-SDK/project-spec/configs/configs/Kconfig.yoctobuildsettings
```

## PetaLinux-SDK/project-spec/configs/configs/Kconfig.syshw
```kconfig
menu "Subsystem Hardware Settings"

config SUBSYSTEM_PROCESSOR0_IP_NAME
	string
	default ps7_cortexa9_0

config SUBSYSTEM_ENABLE_ARCH64
	bool
	default y
	select SUBSYSTEM_ARCH_AARCH64
	depends on SUBSYSTEM_PROCESSOR_ps7_cortexa9_0_SELECT

choice
	prompt "System Processor"
	help
	Select a processor as the system processor.

config SUBSYSTEM_PROCESSOR_ps7_cortexa9_0_SELECT
	bool "ps7_cortexa9_0"

endchoice

if SUBSYSTEM_PROCESSOR_ps7_cortexa9_0_SELECT

menu "Memory Settings"
choice
	prompt "Primary Memory"
	default SUBSYSTEM_MEMORY_PS7_DDR_0_SELECT

	help
	The configuration in this menu impacts the
	memory settings in the device tree autoconfig files.
	If you select "manual",
	Auto generate the memory node based on user inputs,
	you will need to specify base address and memory size.
	To skip generating lower or upper memory node specify 0x0 offset to the memory size.

config SUBSYSTEM_MEMORY_PS7_DDR_0_SELECT
	bool "ps7_ddr_0"

config SUBSYSTEM_MEMORY_MANUAL_SELECT
	bool "manual"

endchoice

config SUBSYSTEM_MEMORY_PS7_DDR_0_BASEADDR
	hex "System memory base address"
	default 0x100000
	range 0x100000 0x1e000000
	depends on SUBSYSTEM_MEMORY_PS7_DDR_0_SELECT
	help
	Start address of the system memory.
	It has to be within the selected primary memory physical address range.
	Make sure the DT memory entry should start with provided address.

config SUBSYSTEM_MEMORY_PS7_DDR_0_SIZE
	hex "System memory size"
	default 0x1ff00001
	range 0x2000000 0x1ff00001
	depends on SUBSYSTEM_MEMORY_PS7_DDR_0_SELECT
	help
	Size of the system memory. Minimum is 32MB, maximum is the size of
	the selected primary memory physical address range.

config SUBSYSTEM_MEMORY_PS7_DDR_0_U__BOOT_TEXTBASE_OFFSET
	hex "u-boot text base address"
	default 0x40100000 if SYSTEM_VERSAL-2VE-2VM
	default 0x8100000 if SUBSYSTEM_ARCH_AARCH64
	default 0x4100000 if SUBSYSTEM_ARCH_ARM
	default 0x200000 if SUBSYSTEM_ARCH_MICROBLAZE
	range 0x200000 0x1e200000
	depends on SUBSYSTEM_MEMORY_PS7_DDR_0_SELECT
	depends on !SUBSYSTEM_COMPONENT_U__BOOT_NAME_NONE
	help
	u-boot text base address by specifying from the memory base address.
	u-boot load address = bank base address + offset. And same value will
	pass to TF-A also. Minimum suggested is 1MB.

config SUBSYSTEM_MEMORY_IP_NAME
	string
	default ps7_ddr_0
	depends on SUBSYSTEM_MEMORY_PS7_DDR_0_SELECT

config SUBSYSTEM_MEMORY_MANUAL_LOWER_BASEADDR
	hex "Lower memory base address"
	default 0x0
	depends on SUBSYSTEM_MEMORY_MANUAL_SELECT
	help
	base address of the lower memory
	Make sure the DT memory entry should start with provided address.

config SUBSYSTEM_MEMORY_MANUAL_LOWER_MEMORYSIZE
	hex "Lower memory size"
	default 0x80000000
	depends on SUBSYSTEM_MEMORY_MANUAL_SELECT
	help
	Size of the lower memory. Minimum is 32MB, maximum is the size of
	the selected primary memory physical address range.
	If you specify 0x0 offset then it will skip generating lower memory node.

config SUBSYSTEM_MEMORY_MANUAL_UPPER_BASEADDR
	hex "Upper memory base address"
	default 0x800000000
	depends on SUBSYSTEM_MEMORY_MANUAL_SELECT
	depends on SUBSYSTEM_ARCH_AARCH64
	help
	base address of the upper memory
	Make sure the DT memory entry should start with provided address.

config SUBSYSTEM_MEMORY_MANUAL_UPPER_MEMORYSIZE
	hex "Upper memory size"
	default 0x80000000
	depends on SUBSYSTEM_MEMORY_MANUAL_SELECT
	depends on SUBSYSTEM_ARCH_AARCH64
	help
	Size of the lower memory. Minimum is 32MB, maximum is the size of
	the selected primary memory physical address range.
	If you specify 0x0 offset then it will skip generating lower memory node.

endmenu

menu "Serial Settings"

choice
	prompt "FSBL Serial stdin/stdout"
	help
	Select a serial as the FSBL's stdin,stdout.
	If you select 'manual', you will need to add this variable
	For XSCT flow:
	 YAML_SERIAL_CONSOLE_STDIN:forcevariable:pn-<recipename> = "<serial_ipname>"
	 YAML_SERIAL_CONSOLE_STDOUT:forcevariable:pn-<recipename> = "<serial_ipname>"
	 in petalinuxbsp.conf file or local.conf to specify the stdin/stdout."

config SUBSYSTEM_FSBL_SERIAL_UART0_SELECT
	bool "uart0"

config SUBSYSTEM_FSBL_SERIAL_MANUAL_SELECT
	bool "manual"

endchoice

choice
	prompt "U-boot/Linux Serial stdin/stdout"
	help
	Select a serial as the U-boot and Linux's stdin,stdout.
	If you select 'manual', you will need to add this variable
	For XSCT flow:
	 YAML_SERIAL_CONSOLE_STDIN:forcevariable:pn-<recipename> = "<serial_ipname>"
	 YAML_SERIAL_CONSOLE_STDOUT:forcevariable:pn-<recipename> = "<serial_ipname>"
	 in petalinuxbsp.conf file or local.conf to specify the stdin/stdout."

config SUBSYSTEM_SERIAL_UART0_SELECT
	bool "uart0"

config SUBSYSTEM_SERIAL_MANUAL_SELECT
	bool "manual"

endchoice

choice
	prompt "System stdin/stdout baudrate for uart0"
	default SUBSYSTEM_SERIAL_UART0_BAUDRATE_115200
	help
	Baudrate settings for serial Ip uart0
	The Baudrate setting applies only for U-boot/Linux serial Ip

config SUBSYSTEM_SERIAL_UART0_BAUDRATE_600
	bool "600"

config SUBSYSTEM_SERIAL_UART0_BAUDRATE_9600
	bool "9600"

config SUBSYSTEM_SERIAL_UART0_BAUDRATE_28800
	bool "28800"

config SUBSYSTEM_SERIAL_UART0_BAUDRATE_115200
	bool "115200"

config SUBSYSTEM_SERIAL_UART0_BAUDRATE_230400
	bool "230400"

config SUBSYSTEM_SERIAL_UART0_BAUDRATE_460800
	bool "460800"

config SUBSYSTEM_SERIAL_UART0_BAUDRATE_921600
	bool "921600"

endchoice

config SUBSYSTEM_SERIAL_FSBL_IP_NAME
	string
	default uart0 if SUBSYSTEM_FSBL_SERIAL_UART0_SELECT

config SUBSYSTEM_SERIAL_IP_NAME
	string
	default uart0 if SUBSYSTEM_SERIAL_UART0_SELECT

endmenu

menu "Ethernet Settings"

choice
	prompt "Primary Ethernet"
	help
	Select a Ethernet used as primary Ethernet.
	The primary ethernet will be used for u-boot networking if u-boot is
	selected and will be used as eth0 in Linux.
	If your preferred primary ethernet is not on the list, please select"
	'manual'.

config SUBSYSTEM_ETHERNET_GEM0_SELECT
	bool "gem0"

config SUBSYSTEM_ETHERNET_MANUAL_SELECT
	bool "manual"

endchoice

config SUBSYSTEM_ETHERNET_GEM0_MAC_AUTO
	bool "Randomise MAC address"
	default y if SUBSYSTEM_ARCH_MICROBLAZE
	default n
	depends on SUBSYSTEM_ETHERNET_GEM0_SELECT
	help
	randomise MAC address for the primary ethernet.

config SUBSYSTEM_ETHERNET_GEM0_MAC_PATTERN
	string "Template for randomised MAC address"
	default "00:0a:35:00:??:??"
	depends on SUBSYSTEM_ETHERNET_GEM0_SELECT && SUBSYSTEM_ETHERNET_GEM0_MAC_AUTO
	help
	Pattern for generating random MAC addresses - question mark
	characters will be replaced by random hex digits

config SUBSYSTEM_ETHERNET_GEM0_MAC
	string "Ethernet MAC address"
	depends on SUBSYSTEM_ETHERNET_GEM0_SELECT && !SUBSYSTEM_ETHERNET_GEM0_MAC_AUTO
	help
	Default mac address will set from eeprom fru data
	if you want change with desired value you can change, example: 00:0a:35:00:22:01 or ff:ff:ff:ff:ff:ff

config SUBSYSTEM_ETHERNET_GEM0_USE_DHCP
	bool "Obtain IP address automatically"
	default y
	depends on SUBSYSTEM_ETHERNET_GEM0_SELECT
	help
	Set this option if you would like your SUBSYSTEM to use DHCP for
	obtaining an IP address.

config SUBSYSTEM_ETHERNET_GEM0_IP_ADDRESS
	string "Static IP address"
	default "192.168.0.10"
	depends on SUBSYSTEM_ETHERNET_GEM0_SELECT && !SUBSYSTEM_ETHERNET_GEM0_USE_DHCP
	help
	The IP address of your main network interface when static network
	address assignment is used.

config SUBSYSTEM_ETHERNET_GEM0_IP_NETMASK
	string "Static IP netmask"
	default "255.255.255.0"
	depends on SUBSYSTEM_ETHERNET_GEM0_SELECT && !SUBSYSTEM_ETHERNET_GEM0_USE_DHCP
	help
	Default netmask when static network address assignment is used.
	In case of systemd please specify netmask value like CIDR notation Eg: 24 instead of 255.255.255.0
	In case of sysvinit please specify netmask value like dot-decimal notation Eg: 255.255.255.0 instead of 24

config SUBSYSTEM_ETHERNET_GEM0_IP_GATEWAY
	string "Static IP gateway"
	default "192.168.0.1"
	depends on SUBSYSTEM_ETHERNET_GEM0_SELECT && !SUBSYSTEM_ETHERNET_GEM0_USE_DHCP
	help
	Default gateway when static network address assignment is used.

endmenu

menu "Flash Settings"

choice
	prompt "Primary Flash"
	help
	Select a Flash instance used as Primary Flash.
	Auto config will apply the flash partition table settings
	to the primary flash.
	If you preferred flash is not on the list or you don't want
	to manage your flash partition, please select manual.

config SUBSYSTEM_FLASH_MANUAL_SELECT
	bool "manual"

endchoice

endmenu

menu "SD/SDIO Settings"

choice
	prompt "Primary SD/SDIO"
	help
	Select a SD instanced used as primary SD/SDIO.
	It allows you to select which SD controller is in the systems primary SD card interface.

config SUBSYSTEM_PRIMARY_SD_SDHCI0_SELECT
	bool "sdhci0"

config SUBSYSTEM_PRIMARY_SD_MANUAL_SELECT
	bool "manual"

endchoice

endmenu

endif

endmenu
```

## PetaLinux-SDK/project-spec/configs/rootfsconfigs/Kconfig.user
```kconfig
menu "user packages " 
config bootscript  
	 bool "bootscript"
	 help
	
config gpio-demo  
	 bool "gpio-demo"
	 help
	
config peekpoke  
	 bool "peekpoke"
	 help
	
endmenu
```

## Yocto-EDF/build/conf/bblayers.conf
```bitbake
# POKY_BBLAYERS_CONF_VERSION is increased each time build/conf/bblayers.conf
# changes incompatibly
POKY_BBLAYERS_CONF_VERSION = "2"

BBPATH = "${TOPDIR}"
BBFILES ?= ""

BBLAYERS ?= " \
  /home/lanza/workspace/Digilent-Yocto-Test/Yocto-EDF/sources/poky/meta \
  /home/lanza/workspace/Digilent-Yocto-Test/Yocto-EDF/sources/poky/meta-poky \
  /home/lanza/workspace/Digilent-Yocto-Test/Yocto-EDF/sources/poky/../meta-openembedded/meta-oe \
  /home/lanza/workspace/Digilent-Yocto-Test/Yocto-EDF/sources/poky/../meta-openembedded/meta-python \
  /home/lanza/workspace/Digilent-Yocto-Test/Yocto-EDF/sources/poky/../meta-openembedded/meta-filesystems \
  /home/lanza/workspace/Digilent-Yocto-Test/Yocto-EDF/sources/poky/../meta-openembedded/meta-networking \
  /home/lanza/workspace/Digilent-Yocto-Test/Yocto-EDF/sources/poky/../meta-openembedded/meta-multimedia \
  /home/lanza/workspace/Digilent-Yocto-Test/Yocto-EDF/sources/poky/../meta-openembedded/meta-webserver \
  /home/lanza/workspace/Digilent-Yocto-Test/Yocto-EDF/sources/poky/../meta-virtualization \
  /home/lanza/workspace/Digilent-Yocto-Test/Yocto-EDF/sources/poky/../meta-security \
  /home/lanza/workspace/Digilent-Yocto-Test/Yocto-EDF/sources/poky/../meta-security/meta-tpm \
  /home/lanza/workspace/Digilent-Yocto-Test/Yocto-EDF/sources/poky/../meta-xilinx/meta-xilinx-core \
  /home/lanza/workspace/Digilent-Yocto-Test/Yocto-EDF/sources/poky/../meta-xilinx/meta-xilinx-standalone \
  /home/lanza/workspace/Digilent-Yocto-Test/Yocto-EDF/sources/poky/../meta-xilinx/meta-xilinx-standalone-sdt \
  /home/lanza/workspace/Digilent-Yocto-Test/Yocto-EDF/sources/poky/../meta-xilinx/meta-xilinx-multimedia \
  /home/lanza/workspace/Digilent-Yocto-Test/Yocto-EDF/sources/poky/../meta-xilinx/meta-xilinx-demos \
  /home/lanza/workspace/Digilent-Yocto-Test/Yocto-EDF/sources/poky/../meta-xilinx/meta-xilinx-virtualization \
  /home/lanza/workspace/Digilent-Yocto-Test/Yocto-EDF/sources/poky/../meta-xilinx/meta-xilinx-mali400 \
  /home/lanza/workspace/Digilent-Yocto-Test/Yocto-EDF/sources/poky/../meta-xilinx/meta-xilinx-gpu-malig78ae \
  /home/lanza/workspace/Digilent-Yocto-Test/Yocto-EDF/sources/poky/../meta-xilinx/meta-microblaze \
  /home/lanza/workspace/Digilent-Yocto-Test/Yocto-EDF/sources/poky/../meta-xilinx-tsn \
  /home/lanza/workspace/Digilent-Yocto-Test/Yocto-EDF/sources/poky/../meta-openamp \
  /home/lanza/workspace/Digilent-Yocto-Test/Yocto-EDF/sources/poky/../meta-amd-edf \
  /home/lanza/workspace/Digilent-Yocto-Test/Yocto-EDF/sources/poky/../meta-kria \
  /home/lanza/workspace/Digilent-Yocto-Test/Yocto-EDF/sources/poky/../meta-amd-adaptive-socs/meta-amd-adaptive-socs-core \
  /home/lanza/workspace/Digilent-Yocto-Test/Yocto-EDF/sources/poky/../meta-amd-adaptive-socs/meta-amd-adaptive-socs-bsp \
  /home/lanza/workspace/Digilent-Yocto-Test/Yocto-EDF/sources/poky/../meta-xilinx/meta-xilinx-imgrcvry \
  /home/lanza/workspace/Digilent-Yocto-Test/Yocto-EDF/sources/poky/../meta-arm/meta-arm \
  /home/lanza/workspace/Digilent-Yocto-Test/Yocto-EDF/sources/poky/../meta-arm/meta-arm-toolchain \
  /home/lanza/workspace/Digilent-Yocto-Test/Yocto-EDF/sources/poky/../meta-jupyter \
  /home/lanza/workspace/Digilent-Yocto-Test/Yocto-EDF/sources/poky/../meta-ros/meta-ros-common \
  /home/lanza/workspace/Digilent-Yocto-Test/Yocto-EDF/sources/poky/../meta-ros/meta-ros2 \
  /home/lanza/workspace/Digilent-Yocto-Test/Yocto-EDF/sources/poky/../meta-ros/meta-ros2-jazzy \
  /home/lanza/workspace/Digilent-Yocto-Test/Yocto-EDF/sources/poky/../meta-qt5 \
  /home/lanza/workspace/Digilent-Yocto-Test/Yocto-EDF/sources/poky/../meta-vitis \
  /home/lanza/workspace/Digilent-Yocto-Test/Yocto-EDF/sources/meta-custom \
  "
```

## Yocto-EDF/sources/meta-amd-adaptive-socs/meta-amd-adaptive-socs-bsp/conf/machine/include/versal-l20-sdt-seg/versal-l20-sdt-seg-microblaze-psm-features.conf
```bitbake
MACHINE_FEATURES = "canfd cframe cfupmc common csudma emacps iicps iomodule ipipsu qspipsu rtcpsu sdps sysmonpsv tmr-inject tmr-manager ttcps uartpsv usbpsu zdma"
```
