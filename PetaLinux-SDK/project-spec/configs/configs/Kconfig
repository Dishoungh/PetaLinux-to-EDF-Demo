## Yocto-PetaLinux/sources/meta-amd-adaptive-socs/meta-amd-adaptive-socs-bsp/conf/layer.conf
```bitbake
# We have a conf and classes directory, add to BBPATH
BBPATH .= ":${LAYERDIR}"

# We have recipes-* directories, add to BBFILES
BBFILES += "${LAYERDIR}/recipes-*/*/*.bb \
            ${LAYERDIR}/recipes-*/*/*.bbappend"

BBFILE_COLLECTIONS += "amd-adaptive-socs-bsp"
BBFILE_PATTERN_amd-adaptive-socs-bsp = "^${LAYERDIR}/"
BBFILE_PRIORITY_amd-adaptive-socs-bsp = "6"

BBFILES_DYNAMIC += " \
amd-edf:${LAYERDIR}/dynamic-layers/meta-amd-edf/recipes-*/*/*.bb \
amd-edf:${LAYERDIR}/dynamic-layers/meta-amd-edf/recipes-*/*/*.bbappend \
meta-xilinx-imgrcry:${LAYERDIR}/dynamic-layers/meta-xilinx-imgrcvry/recipes-*/*/*.bb \
meta-xilinx-imgrcry:${LAYERDIR}/dynamic-layers/meta-xilinx-imgrcvry/recipes-*/*/*.bbappend \
xilinx-standalone-sdt:${LAYERDIR}/dynamic-layers/xilinx-standalone-sdt/recipes-*/*/*.bb \
xilinx-standalone-sdt:${LAYERDIR}/dynamic-layers/xilinx-standalone-sdt/recipes-*/*/*.bbappend \
"

LAYERDEPENDS_amd-adaptive-socs-bsp = "\
    core \
    xilinx \
    xilinx-standalone \
    xilinx-standalone-sdt \
    xilinx-microblaze \
    xilinx-multimedia \
    "

LAYERRECOMMENDS_amd-adaptive-socs-bsp = "\
    amd-adaptive-socs-core \
    openamp-layer \
    xilinx-virtualization \
    virtualization-layer \
    security \
    tpm-layer \
    "

LAYERSERIES_COMPAT_amd-adaptive-socs-bsp = "scarthgap"

# We need to set sdtgen dts and pdi path in machine conf files instead of
# hardcoded path which was generated during gen-machine-conf sdt processing.
BSPLAYERDIR_amd-adaptive-socs-bsp = "${LAYERDIR}"
```

## Yocto-PetaLinux/sources/meta-amd-adaptive-socs/meta-amd-adaptive-socs-bsp/conf/machine/include/versal-v80-sdt-seg/versal-v80-sdt-seg-microblaze-pmc-features.conf
```bitbake
MACHINE_FEATURES = "cframe cfupmc common csudma gpiops iicps iomodule ipipsu ospipsv rtcpsu sdps spips sysmonpsv tmr-inject tmr-manager trngpsv ttcps uartlite uartpsv zdma"
```

## Yocto-PetaLinux/sources/meta-amd-adaptive-socs/meta-amd-adaptive-socs-bsp/conf/machine/include/versal-vek280-sdt-seg/versal-vek280-sdt-seg-cortexa72-1-freertos-features.conf
```bitbake
MACHINE_FEATURES = "canfd cframe cfupmc common coresightps-dcc csudma emacps gpio gpiops iicps intc ipipsu ospipsv rtcpsu scugic sdps sysmonpsv trngpsv ttcps uartlite uartpsv usbpsu zdma"
```

## Yocto-PetaLinux/sources/meta-amd-adaptive-socs/meta-amd-adaptive-socs-bsp/conf/machine/include/versal-vek280-sdt-seg/versal-vek280-sdt-seg-microblaze-pmc-features.conf
```bitbake
MACHINE_FEATURES = "bram canfd cframe cfupmc common csudma emacps gpio gpiops iicps iomodule ipipsu ospipsv rtcpsu sdps sysmonpsv tmr-inject tmr-manager trngpsv ttcps uartlite uartpsv usbpsu zdma"
```

## Yocto-PetaLinux/sources/meta-amd-adaptive-socs/meta-amd-adaptive-socs-bsp/conf/machine/include/zynqmp-zcu104-sdt-full/zynqmp-zcu104-sdt-full-cortexr5-fsbl-features.conf
```bitbake
MACHINE_FEATURES = "avbuf axipmon canps clockps common coresightps-dcc csudma ddrcpsu dpdma dppsu emacps gpiops iicps intc ipipsu qspipsu resetps rtcpsu scugic sdps sysmonpsu ttcps uartps usbpsu v-frmbuf-rd v-frmbuf-wr video-common wdtps zdma"
```

## Yocto-PetaLinux/sources/meta-amd-adaptive-socs/meta-amd-adaptive-socs-bsp/conf/machine/include/zynqmp-zcu104-sdt-full/zynqmp-zcu104-sdt-full-microblaze-pmu-features.conf
```bitbake
MACHINE_FEATURES = "avbuf axipmon canps clockps common csudma ddrcpsu dpdma dppsu emacps gpiops iicps intc ipipsu qspipsu resetps rtcpsu sdps sysmonpsu ttcps uartps usbpsu v-frmbuf-rd v-frmbuf-wr video-common wdtps zdma"
```

## Yocto-PetaLinux/sources/meta-amd-adaptive-socs/meta-amd-adaptive-socs-bsp/conf/machine/include/zynqmp-zcu111-sdt-full/zynqmp-zcu111-sdt-full-cortexa53-fsbl-features.conf
```bitbake
MACHINE_FEATURES = "avbuf axipmon bram clockps common coresightps-dcc csudma ddrcpsu dpdma dppsu emacps gpio gpiops iicps ipipsu qspipsu resetps rtcpsu scugic sdps sysmonpsu ttcps uartps usbpsu video-common wdtps zdma"
```

## Yocto-PetaLinux/sources/meta-amd-adaptive-socs/meta-amd-adaptive-socs-bsp/conf/machine/versal-l20-sdt-seg.conf
```bitbake
#@TYPE: Machine
#@NAME: versal-l20-sdt-seg
#@DESCRIPTION: Machine configuration for the versal-l20-sdt-seg boards.

BBMULTICONFIG += "versal-l20-sdt-seg-microblaze-pmc versal-l20-sdt-seg-microblaze-psm"

#### Preamble
MACHINEOVERRIDES =. "${@['', 'versal-l20-sdt-seg:']['versal-l20-sdt-seg' !='${MACHINE}']}"
#### Regular settings follow
TUNEFILE[microblaze-pmc] = "conf/machine/include/versal-l20-sdt-seg/microblaze.inc"
TUNEFILE[microblaze-psm] = "conf/machine/include/versal-l20-sdt-seg/microblaze.inc"

# Platform Loader and Manager
PLM_DEPENDS = ""
PLM_MCDEPENDS = "mc::versal-l20-sdt-seg-microblaze-pmc:plm-firmware:do_deploy"
PLM_DEPLOY_DIR = "${TMPDIR}-versal-l20-sdt-seg-microblaze-pmc/deploy/images/${MACHINE}"

# PSM Firware
PSM_DEPENDS = ""
PSM_MCDEPENDS = "mc::versal-l20-sdt-seg-microblaze-psm:psm-firmware:do_deploy"
PSM_FIRMWARE_DEPLOY_DIR = "${TMPDIR}-versal-l20-sdt-seg-microblaze-psm/deploy/images/${MACHINE}"

# Set the default (linux) domain device tree
CONFIG_DTFILE_DIR := "${@bb.utils.which(d.getVar('BBPATH'), 'conf/dts/versal-l20-sdt-seg')}"
CONFIG_DTFILE ?= "${CONFIG_DTFILE_DIR}/cortexa72-linux.dts"
CONFIG_DTFILE[vardepsexclude] += "CONFIG_DTFILE_DIR"

# Yocto arm-trusted-firmware(TF-A) variables
TFA_CONSOLE ?= "pl011"
TFA_BL33_LOAD ?= "0x8000000"

# Set DDR Base address for u-boot-xlnx-scr variables
DDR_BASEADDR ?= "0x0"
SKIP_APPEND_BASEADDR ?= "0"

# Yocto KERNEL Variables
UBOOT_ENTRYPOINT  ?= "0x200000"
UBOOT_LOADADDRESS ?= "0x200000"

# Yocto MACHINE_FEATURES Variable
MACHINE_FEATURES += "fpga-overlay"

# Required generic machine inclusion
require conf/machine/versal-generic.conf

QB_MEM = "-m 8G"
QEMU_HW_DTB_PS = "${QEMU_HW_DTB_PATH}/board-versal-ps-vm-p-m1369-00.dtb"
QEMU_HW_DTB_PMC = "${QEMU_HW_DTB_PATH}/board-versal-pmc-virt.dtb"
QB_ROOTFS_OPT = "-drive if=sd,index=1,file=@ROOTFS@,format=raw"


# This is an 'SDT' based BSP
XILINX_WITH_ESW = "sdt"

# Original SDT artifacts URL
SDT_URI = "https://petalinux.xilinx.com/sswreleases/rel-v2025.1/sdt/2025.1/2025.1_0530_1_07282301/external/versal-l20-sdt-seg/versal-l20-sdt-seg_2025.1_0530_1_07282301.tar.gz"
SDT_URI[sha256sum] = "dcc8393d26c125db6d14cf95a40de7616436e3ce90288a0d0d8d9b13c174f617"
SDT_URI[S] = "${WORKDIR}/versal-l20-sdt-seg_2025.1_0530_1_07282301"

# Set the system device trees
SYSTEM_DTFILE_DEPENDS = "sdt-artifacts"
SYSTEM_DTFILE_DIR = "${RECIPE_SYSROOT}${datadir}/sdt/${MACHINE}"
SYSTEM_DTFILE = "${SYSTEM_DTFILE_DIR}/system-top.dts"

# Load the dynamic machine features
include conf/machine/include/versal-l20-sdt-seg/${BB_CURRENT_MC}-features.conf
LIBXIL_CONFIG = "conf/machine/include/versal-l20-sdt-seg/${BB_CURRENT_MC}-libxil.conf"

# Versal PDI
PDI_PATH_DEPENDS = "sdt-artifacts"
PDI_PATH_DIR = "${RECIPE_SYSROOT}${datadir}/sdt/${MACHINE}"
PDI_PATH = "${PDI_PATH_DIR}/l20_base_boot.pdi"

# Update bootbin to use proper device tree
BIF_PARTITION_IMAGE[device-tree] = "${RECIPE_SYSROOT}/boot/devicetree/${@os.path.basename(d.getVar('CONFIG_DTFILE').replace('.dts', '.dtb'))}"

# Remap boot files to ensure the right device tree is listed first
IMAGE_BOOT_FILES =+ "devicetree/${@os.path.basename(d.getVar('CONFIG_DTFILE').replace('.dts', '.dtb'))}"

#### No additional settings should be after the Postamble
#### Postamble
PACKAGE_EXTRA_ARCHS:append = "${@['', ' versal_l20_sdt_seg']['versal-l20-sdt-seg' != '${MACHINE}']}"
```
