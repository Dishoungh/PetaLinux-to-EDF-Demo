## Yocto-EDF/sources/meta-amd-adaptive-socs/meta-amd-adaptive-socs-bsp/conf/machine/include/versal-vck190-sdt-seg/versal-vck190-sdt-seg-microblaze-psm-features.conf
```bitbake
MACHINE_FEATURES = "bram canfd cframe cfupmc common csudma emacps gpio gpiops iicps iomodule ipipsu qspipsu rtcpsu sdps sysmonpsv tmr-inject tmr-manager trngpsv ttcps uartlite uartpsv usbpsu zdma"
```

## Yocto-EDF/sources/meta-amd-adaptive-socs/meta-amd-adaptive-socs-bsp/conf/machine/include/versal-vek280-sdt-seg/versal-vek280-sdt-seg-cortexr5-0-freertos-libxil.conf
```bitbake
PACKAGECONFIG[canfd] = "${RECIPE_SYSROOT}/usr/lib/libcanfd.a,,canfd,,"
PACKAGECONFIG[cframe] = "${RECIPE_SYSROOT}/usr/lib/libcframe.a,,cframe,,"
PACKAGECONFIG[cfupmc] = "${RECIPE_SYSROOT}/usr/lib/libcfupmc.a,,cfupmc,,"
PACKAGECONFIG[common] = "${RECIPE_SYSROOT}/usr/lib/libcommon.a,,common,,"
PACKAGECONFIG[coresightps-dcc] = "${RECIPE_SYSROOT}/usr/lib/libcoresightps_dcc.a,,coresightps-dcc,,"
PACKAGECONFIG[csudma] = "${RECIPE_SYSROOT}/usr/lib/libcsudma.a,,csudma,,"
PACKAGECONFIG[emacps] = "${RECIPE_SYSROOT}/usr/lib/libemacps.a,,emacps,,"
PACKAGECONFIG[gpio] = "${RECIPE_SYSROOT}/usr/lib/libgpio.a,,gpio,,"
PACKAGECONFIG[gpiops] = "${RECIPE_SYSROOT}/usr/lib/libgpiops.a,,gpiops,,"
PACKAGECONFIG[iicps] = "${RECIPE_SYSROOT}/usr/lib/libiicps.a,,iicps,,"
PACKAGECONFIG[intc] = "${RECIPE_SYSROOT}/usr/lib/libintc.a,,intc,,"
PACKAGECONFIG[ipipsu] = "${RECIPE_SYSROOT}/usr/lib/libipipsu.a,,ipipsu,,"
PACKAGECONFIG[ospipsv] = "${RECIPE_SYSROOT}/usr/lib/libospipsv.a,,ospipsv,,"
PACKAGECONFIG[rtcpsu] = "${RECIPE_SYSROOT}/usr/lib/librtcpsu.a,,rtcpsu,,"
PACKAGECONFIG[scugic] = "${RECIPE_SYSROOT}/usr/lib/libscugic.a,,scugic,,"
PACKAGECONFIG[sdps] = "${RECIPE_SYSROOT}/usr/lib/libsdps.a,,sdps,,"
PACKAGECONFIG[sysmonpsv] = "${RECIPE_SYSROOT}/usr/lib/libsysmonpsv.a,,sysmonpsv,,"
PACKAGECONFIG[trngpsv] = "${RECIPE_SYSROOT}/usr/lib/libtrngpsv.a,,trngpsv,,"
PACKAGECONFIG[ttcps] = "${RECIPE_SYSROOT}/usr/lib/libttcps.a,,ttcps,,"
PACKAGECONFIG[uartlite] = "${RECIPE_SYSROOT}/usr/lib/libuartlite.a,,uartlite,,"
PACKAGECONFIG[uartpsv] = "${RECIPE_SYSROOT}/usr/lib/libuartpsv.a,,uartpsv,,"
PACKAGECONFIG[usbpsu] = "${RECIPE_SYSROOT}/usr/lib/libusbpsu.a,,usbpsu,,"
PACKAGECONFIG[zdma] = "${RECIPE_SYSROOT}/usr/lib/libzdma.a,,zdma,,"
```

## Yocto-EDF/sources/meta-amd-adaptive-socs/meta-amd-adaptive-socs-bsp/conf/machine/include/zynqmp-zcu104-sdt-full/zynqmp-zcu104-sdt-full-microblaze-pmu-libxil.conf
```bitbake
PACKAGECONFIG[avbuf] = "${RECIPE_SYSROOT}/usr/lib/libavbuf.a,,avbuf,,"
PACKAGECONFIG[axipmon] = "${RECIPE_SYSROOT}/usr/lib/libaxipmon.a,,axipmon,,"
PACKAGECONFIG[canps] = "${RECIPE_SYSROOT}/usr/lib/libcanps.a,,canps,,"
PACKAGECONFIG[clockps] = "${RECIPE_SYSROOT}/usr/lib/libclockps.a,,clockps,,"
PACKAGECONFIG[common] = "${RECIPE_SYSROOT}/usr/lib/libcommon.a,,common,,"
PACKAGECONFIG[csudma] = "${RECIPE_SYSROOT}/usr/lib/libcsudma.a,,csudma,,"
PACKAGECONFIG[ddrcpsu] = "${RECIPE_SYSROOT}/usr/lib/libddrcpsu.a,,ddrcpsu,,"
PACKAGECONFIG[dpdma] = "${RECIPE_SYSROOT}/usr/lib/libdpdma.a,,dpdma,,"
PACKAGECONFIG[dppsu] = "${RECIPE_SYSROOT}/usr/lib/libdppsu.a,,dppsu,,"
PACKAGECONFIG[emacps] = "${RECIPE_SYSROOT}/usr/lib/libemacps.a,,emacps,,"
PACKAGECONFIG[gpiops] = "${RECIPE_SYSROOT}/usr/lib/libgpiops.a,,gpiops,,"
PACKAGECONFIG[iicps] = "${RECIPE_SYSROOT}/usr/lib/libiicps.a,,iicps,,"
PACKAGECONFIG[intc] = "${RECIPE_SYSROOT}/usr/lib/libintc.a,,intc,,"
PACKAGECONFIG[ipipsu] = "${RECIPE_SYSROOT}/usr/lib/libipipsu.a,,ipipsu,,"
PACKAGECONFIG[qspipsu] = "${RECIPE_SYSROOT}/usr/lib/libqspipsu.a,,qspipsu,,"
PACKAGECONFIG[resetps] = "${RECIPE_SYSROOT}/usr/lib/libresetps.a,,resetps,,"
PACKAGECONFIG[rtcpsu] = "${RECIPE_SYSROOT}/usr/lib/librtcpsu.a,,rtcpsu,,"
PACKAGECONFIG[sdps] = "${RECIPE_SYSROOT}/usr/lib/libsdps.a,,sdps,,"
PACKAGECONFIG[sysmonpsu] = "${RECIPE_SYSROOT}/usr/lib/libsysmonpsu.a,,sysmonpsu,,"
PACKAGECONFIG[ttcps] = "${RECIPE_SYSROOT}/usr/lib/libttcps.a,,ttcps,,"
PACKAGECONFIG[uartps] = "${RECIPE_SYSROOT}/usr/lib/libuartps.a,,uartps,,"
PACKAGECONFIG[usbpsu] = "${RECIPE_SYSROOT}/usr/lib/libusbpsu.a,,usbpsu,,"
PACKAGECONFIG[v-frmbuf-rd] = "${RECIPE_SYSROOT}/usr/lib/libv_frmbuf_rd.a,,v-frmbuf-rd,,"
PACKAGECONFIG[v-frmbuf-wr] = "${RECIPE_SYSROOT}/usr/lib/libv_frmbuf_wr.a,,v-frmbuf-wr,,"
PACKAGECONFIG[video-common] = "${RECIPE_SYSROOT}/usr/lib/libvideo_common.a,,video-common,,"
PACKAGECONFIG[wdtps] = "${RECIPE_SYSROOT}/usr/lib/libwdtps.a,,wdtps,,"
PACKAGECONFIG[zdma] = "${RECIPE_SYSROOT}/usr/lib/libzdma.a,,zdma,,"
```

## Yocto-EDF/sources/meta-amd-edf/conf/distro/amd-edf.conf
```bitbake
require conf/distro/poky-altcfg.conf

include conf/distro/include/amd-edf-feed.conf

# Because we are no longer strictly poky-altcfg, set distro variables

DISTRO = "amd-edf"
DISTRO_NAME = "AMD Embedded Development Framework Linux distribution"

# Define the default hostname
hostname:pn-base-files:amd-edf = "amd-edf"

# Based on poky-altcfg
DISTROOVERRIDES = "poky:poky-altcfg:amd-edf"

AMD-EDF_VERSION = "25.05"
AMD-EDF_MINOR = ".2"

# Set to "development" or "release" for release
AMD-EDF_VER_UPDATE = "release"

# This will be set in local.conf for CI builds
AMD-EDF_VER_BUILD ?= "${@'${METADATA_REVISION}' if d.getVar('METADATA_REVISION') != '<unknown>' else 'unknown'}"

# Follow the Poky format of <Version>+<type>-<date>
DISTRO_VERSION = "${AMD-EDF_VERSION}${AMD-EDF_MINOR}+${AMD-EDF_VER_UPDATE}-${AMD-EDF_VER_BUILD}"

SDK_VENDOR = "-amdedfsdk"

MAINTAINER = "AMD AECG <meta-xilinx@yoctoproject.org>"

TARGET_VENDOR = "-amd"

# Define the ROS2 Yocto release
ROS_OE_RELEASE_SERIES = "scarthgap"

# Define ROS2 distro release
ROS_DISTRO = "jazzy"

DISTRO_FEATURES:append = " \
    virtualization \
    openamp \
    multiarch \
    security \
    tpm \
    vmsep \
    xen \
    efi \
    "

# Unset UEFI_PROVIDER as we are not using GRUB or systemd-boot
EFI_PROVIDER ?= ""

# The following really should not refer to MACHINE_FEATURES, but there isn't
# a better way at this point
DISTRO_FEATURES:append = "${@bb.utils.contains('MACHINE_FEATURES', 'mali400', ' libmali', '', d)}"
DISTRO_FEATURES:append = "${@bb.utils.contains('MACHINE_FEATURES', 'malig78ae', ' libmali', '', d)}"
DISTRO_FEATURES[vardepsexclude] += "MACHINE_FEATURES"

# Disable Busybox - Based on Poky example here:
# poky/meta-poky/conf/templates/default/local.conf.sample.extended

PREFERRED_PROVIDER_base-utils = "packagegroup-core-base-utils"
VIRTUAL-RUNTIME_base-utils = "packagegroup-core-base-utils"
VIRTUAL-RUNTIME_base-utils-hwclock = "util-linux-hwclock"
VIRTUAL-RUNTIME_base-utils-syslog = ""

# Enable license package generation
LICENSE_CREATE_PACKAGE = "1"

# Set start-jupyterlab as default start daemon.
PREFERRED_PROVIDER_start-jupyter = "start-jupyterlab"

# AMD EDF builds should use the AMD EDF U-Boot script
UBOOT_BOOT_SCRIPT = "u-boot-edf-scr"
UBOOT_BOOT_SCRIPT:kria = "u-boot-xlnx-scr"

# Configure default users/groups
# Default rules (assumed no debug-tweaks image feature):
# * disabled root login (set by system default)
# * Add a user 'amd-edf' with no password
#   - SSH won't allow passwd-less login w/o debug tweaks, so requires console login
#   - Set to immediately expire
#   - Add to the sudoers file
# * Add 'amd-edf' user to the audio group
# * Add 'amd-edf' user to the video group
IMAGE_CLASSES += "extrausers"
EXTRA_USERS_PARAMS ?= "\
    useradd -p '' amd-edf;passwd-expire amd-edf; \
    groupadd -r aie; \
    usermod -a -G aie,audio,input,video amd-edf; \
"
USERADDEXTENSION:append = " amd-useradd-sudoers"
EXTRA_USERS_SUDOERS ?= "amd-edf ALL=(ALL) ALL;"

# Disable OpenAMP device tree overlay package
ENABLE_OPENAMP_DTSI = "2"

# Include xen dtsi to default dtb until adding IOMMU nodes in SDT is implemented.
ENABLE_XEN_DTSI = "1"
ENABLE_XEN_QEMU_DTSI = "1"
```

## Yocto-EDF/sources/meta-amd-edf/conf/distro/include/amd-edf-feed.conf
```bitbake
PACKAGE_FEED_URIS = "https://petalinux.xilinx.com/sswreleases/amd-edf/${AMD-EDF_VERSION}/generic/rpm/rpm_latest"

# Package feed names always use '_', while ARCH names might include -
PACKAGE_FEED_ARCHS ?= "${@d.getVar('PACKAGE_ARCHS').replace('-','_')}"
```

## Yocto-EDF/sources/meta-amd-edf/wic/edf-default-SM.wks
```
# Partitioned disk image for AMD Embedded Development Framekwork
# Based on a total disk size of 32GB
#
# layout:
#     /boot/efi    512MB    - a place for Arm SystemReady-compatible EFI firmware update capsules
#     /boot        512MB    - traditional /boot (BOOT.bin, u-boot scripts, Linux kernel, device trees, etc)
#     /           7GB       - general-purpose, yocto-built Linux user-space filesystem
#     xen         5GB       - xen dom0
#     ubuntu     12MB*      - 3rd party OS (ubuntu)
#     storage     1GB       - user storage
#
# * NOTE: different 32GB-sized SD cards are different actual sizes
#         for now, since this partition isn't being used, the size
#         has been reduced to ensure the image will fit on all 
#         32GB cards and decrease flashing time

part  /boot/efi                                            --fixed-size=512M  --align 4  --fstype=vfat  --use-label  --label efi      --part-name efi
part  /boot      --source rootfs  --change-directory=boot  --fixed-size=512M  --align 4  --fstype=ext4  --use-label  --label boot     --part-name boot     --active
part  /          --source rootfs  --exclude-path=boot/     --fixed-size=7G    --align 4  --fstype=ext4  --use-label  --label root     --part-name root
part xen                                                   --fixed-size=5G    --align 4  --fstype=ext4  --use-label  --label xen      --part-name xen
part ubuntu                                                --fixed-size=12M   --align 4  --fstype=ext4  --use-label  --label ubuntu   --part-name ubuntu
part storage                                               --fixed-size=1G    --align 4  --fstype=vfat  --use-label  --label storage  --part-name storage

bootloader --ptable gpt
```

## Yocto-EDF/sources/meta-amd-edf/wic/edf-disk-single-rootfs-efi.wks
```
# Partitioned disk image for AMD Embedded Development Framework
# Based on a total disk size of 8GB
#
# layout:
#     /boot/efi    512MB    - used for boot.bin and Arm SystemReady-compatible EFI firmware update capsules
#     /boot        512MB    - traditional /boot (u-boot scripts, Linux kernel, device trees, etc)
#     /            7GB      - general-purpose, Yocto-built Linux user-space filesystem
#     storage      1GB      - user storage

part  /boot/efi  --source bootimg-efi --sourceparams="loader=uefi-kernel"                      --fixed-size 512M  --align 16 --fstype=vfat  --use-label  --label esp  --active  --mbr  --use-uuid  --uuid="${ESP_PART_UUID}"    --part-type="${ESP_PART_TYPE}"  --part-name="ESP"
part  /boot      --source rootfs --change-directory=boot --rootfs-dir=${EDF_IMAGE_ROOTFS_DIR}  --fixed-size=512M  --align 4  --fstype=ext4  --use-label  --label boot --active
part  /          --source rootfs --exclude-path=boot/    --rootfs-dir=${EDF_IMAGE_ROOTFS_DIR}  --fixed-size=7G    --align 4  --fstype=ext4  --use-label  --label root                  --use-uuid  --uuid="${ROOTFS_PART_UUID}" --part-type="${ROOTFS_PART_TYPE}"
part  storage                                                                                  --fixed-size=1G    --align 4  --fstype=vfat  --use-label  --label storage

bootloader --ptable gpt-hybrid
```

## Yocto-EDF/sources/meta-amd-edf/wic/edf-disk-single-rootfs.wks
```
# Partitioned disk image for AMD Embedded Development Framework
# Based on a total disk size of 8GB
#
# layout:
#     /boot/efi    512MB    - used for boot.bin and Arm SystemReady-compatible EFI firmware update capsules
#     /boot        512MB    - traditional /boot (u-boot scripts, Linux kernel, device trees, etc)
#     /            7GB      - general-purpose, Yocto-built Linux user-space filesystem
#     storage      1GB      - user storage

part  /boot/efi                                                                                      --fixed-size=512M  --align 16 --fstype=vfat  --use-label  --label esp
part  /boot      --source rootfs  --change-directory=boot  --rootfs-dir=${EDF_IMAGE_ROOTFS_DIR}      --fixed-size=512M  --align 4  --fstype=ext4  --use-label  --label boot     --active
part  /          --source rootfs  --exclude-path=boot/     --rootfs-dir=${EDF_IMAGE_ROOTFS_DIR}      --fixed-size=7G    --align 4  --fstype=ext4  --use-label  --label root
part  storage                                                                                        --fixed-size=1G    --align 4  --fstype=vfat  --use-label  --label storage

bootloader --ptable msdos
```

## Yocto-EDF/sources/meta-custom/conf/machine/arty-z7.conf
```bitbake
#@TYPE: Machine
#@NAME: arty-z7
#@DESCRIPTION: Machine configuration for the arty-z7 boards.

BBMULTICONFIG += "arty-z7-cortexa9-fsbl"

#### Preamble
MACHINEOVERRIDES =. "${@['', 'arty-z7:']['arty-z7' !='${MACHINE}']}"
#### Regular settings follow

# First Stage Boot Loader
FSBL_DEPENDS = ""
FSBL_MCDEPENDS = "mc::arty-z7-cortexa9-fsbl:fsbl-firmware:do_deploy"
FSBL_DEPLOY_DIR = "${TMPDIR}-arty-z7-cortexa9-fsbl/deploy/images/${MACHINE}"

# Set the default (linux) domain device tree
CONFIG_DTFILE_DIR := "${@bb.utils.which(d.getVar('BBPATH'), 'conf/dts/arty-z7')}"
CONFIG_DTFILE ?= "${CONFIG_DTFILE_DIR}/cortexa9-linux.dts"
CONFIG_DTFILE[vardepsexclude] += "CONFIG_DTFILE_DIR"

# Set DDR Base address for u-boot-xlnx-scr variables
DDR_BASEADDR ?= "0x100000"
SKIP_APPEND_BASEADDR ?= "0"

# Yocto KERNEL Variables
UBOOT_ENTRYPOINT  ?= "0x300000"
UBOOT_LOADADDRESS ?= "0x300000"
KERNEL_EXTRA_ARGS += "UIMAGE_LOADADDR=${UBOOT_ENTRYPOINT}"

# Required generic machine inclusion
require conf/machine/zynq-generic.conf

# This is an 'SDT' based BSP
XILINX_WITH_ESW = "sdt"

# Original SDT artifacts URL
SDT_URI = "file:///home/lanza/workspace/Digilent-Yocto-Test/SDT"
SDT_URI[S] = "${WORKDIR}/home/lanza/workspace/Digilent-Yocto-Test/SDT"

# Set the system device trees
SYSTEM_DTFILE_DEPENDS = "sdt-artifacts"
SYSTEM_DTFILE_DIR = "${RECIPE_SYSROOT}${datadir}/sdt/${MACHINE}"
SYSTEM_DTFILE = "${SYSTEM_DTFILE_DIR}/system-top.dts"

# Load the dynamic machine features
include conf/machine/include/arty-z7/${BB_CURRENT_MC}-features.conf
LIBXIL_CONFIG = "conf/machine/include/arty-z7/${BB_CURRENT_MC}-libxil.conf"

# zynq bitstream path 
BITSTREAM_PATH_DEPENDS = "sdt-artifacts"
BITSTREAM_PATH_DIR = "${RECIPE_SYSROOT}${datadir}/sdt/${MACHINE}"
BITSTREAM_PATH = "${BITSTREAM_PATH_DIR}/Simple.bit"

# Update bootbin to use proper device tree
BIF_PARTITION_IMAGE[device-tree] = "${RECIPE_SYSROOT}/boot/devicetree/${@os.path.basename(d.getVar('CONFIG_DTFILE').replace('.dts', '.dtb'))}"

# Remap boot files to ensure the right device tree is listed first
IMAGE_BOOT_FILES =+ "devicetree/${@os.path.basename(d.getVar('CONFIG_DTFILE').replace('.dts', '.dtb'))}"

#### No additional settings should be after the Postamble
#### Postamble
PACKAGE_EXTRA_ARCHS:append = "${@['', ' arty_z7']['arty-z7' != '${MACHINE}']}"
```

## Yocto-EDF/sources/meta-custom/conf/machine/include/arty-z7/arty-z7-cortexa9-fsbl-features.conf
```bitbake
MACHINE_FEATURES = "common coresightps-dcc devcfg dmaps emacps gpio gpiops qspips scugic scutimer scuwdt sdps uartps usbps xadcps"
```

## Yocto-EDF/sources/meta-xilinx-tsn/conf/layer.conf
```bitbake
# We have a conf and classes directory, add to BBPATH
BBPATH .= ":${LAYERDIR}"

# We have a packages directory, add to BBFILES
BBFILES += " \
		${LAYERDIR}/recipes-*/*/*.bb \
		${LAYERDIR}/recipes-*/*/*.bbappend"

BBFILES_DYNAMIC += " \
    petalinux:${LAYERDIR}/dynamic-layers/petalinux/recipes-*/*/*.bb \
    petalinux:${LAYERDIR}/dynamic-layers/petalinux/recipes-*/*/*.bbappend \
"

BBFILE_COLLECTIONS += "xilinx-tsn"
BBFILE_PATTERN_xilinx-tsn = "^${LAYERDIR}/"
BBFILE_PRIORITY_xilinx-tsn = "6"

LAYERDEPENDS_xilinx-tsn = "\
    core \
    openembedded-layer \
    xilinx \
    "

LAYERSERIES_COMPAT_xilinx-tsn = "scarthgap"
```
