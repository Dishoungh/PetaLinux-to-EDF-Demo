## Yocto-PetaLinux/sources/meta-amd-adaptive-socs/meta-amd-adaptive-socs-core/conf/layer.conf
```bitbake
# We have a conf and classes directory, add to BBPATH
BBPATH .= ":${LAYERDIR}"

# We have recipes-* directories, add to BBFILES
BBFILES += "${LAYERDIR}/recipes-*/*/*.bb \
            ${LAYERDIR}/recipes-*/*/*.bbappend"

BBFILE_COLLECTIONS += "amd-adaptive-socs-core"
BBFILE_PATTERN_amd-adaptive-socs-core = "^${LAYERDIR}/"
# Currently no files, so set an empty pattern means ignore the error
BBFILE_PATTERN_IGNORE_EMPTY_amd-adaptive-socs-core = "1"
BBFILE_PRIORITY_amd-adaptive-socs-core = "6"

LAYERDEPENDS_amd-adaptive-socs-core = "\
    core \
    xilinx \
    xilinx-standalone \
    xilinx-standalone-sdt \
    xilinx-microblaze \
    "

LAYERRECOMMENDS_amd-adaptive-socs-core = "\
     openamp-layer \
     "

LAYERSERIES_COMPAT_amd-adaptive-socs-core = "scarthgap"
```

## Yocto-PetaLinux/sources/meta-embedded-plus/conf/layer.conf
```bitbake
# We have a conf and classes directory, add to BBPATH
BBPATH .= ":${LAYERDIR}"

# We have a packages directory, add to BBFILES
BBFILES += " \
    ${LAYERDIR}/recipes-*/*/*.bb \
    ${LAYERDIR}/recipes-*/*/*.bbappend \
    "

BBFILE_COLLECTIONS += "embedded-plus"
BBFILE_PRIORITY_embedded-plus = "5"
BBFILE_PATTERN_embedded-plus = "^${LAYERDIR}/"
BBFILE_PATTERN_IGNORE_EMPTY_embedded-plus = "1"

LAYERDEPENDS_embedded-plus  = "core xilinx xilinx-standalone xilinx-standalone-sdt xilinx-microblaze amd-adaptive-socs-core"

LAYERRECOMMENDS_embedded-plus = "xilinx-tools"

LAYERSERIES_COMPAT_embedded-plus = "scarthgap"

LAYER_PATH_embedded-plus-layer = "${LAYERDIR}"
```

## Yocto-PetaLinux/sources/meta-embedded-plus/conf/machine/emb-plus-ve2302-amr.conf
```bitbake
#@TYPE: Machine
#@NAME: emb-plus-ve2302-amr
#@DESCRIPTION: Machine configuration for the emb-plus-ve2302-amr boards.

BBMULTICONFIG += "emb-plus-ve2302-amr-microblaze-pmc emb-plus-ve2302-amr-microblaze-psm emb-plus-ve2302-amr-cortexr5-0-freertos"
MACHINEOVERRIDES .= ":emb-plus-amr"

#### Preamble
MACHINEOVERRIDES =. "${@['', 'emb-plus-ve2302-amr:']['emb-plus-ve2302-amr' !='${MACHINE}']}"
#### Regular settings follow
TUNEFILE[microblaze-pmc] = "conf/machine/include/emb-plus-ve2302-amr/microblaze.inc"
TUNEFILE[microblaze-psm] = "conf/machine/include/emb-plus-ve2302-amr/microblaze.inc"

# Platform Loader and Manager
PLM_DEPENDS = ""
PLM_MCDEPENDS = "mc::emb-plus-ve2302-amr-microblaze-pmc:plm-firmware:do_deploy"
PLM_DEPLOY_DIR = "${TMPDIR}-emb-plus-ve2302-amr-microblaze-pmc/deploy/images/${MACHINE}"

# PSM Firware
PSM_DEPENDS = ""
PSM_MCDEPENDS = "mc::emb-plus-ve2302-amr-microblaze-psm:psm-firmware:do_deploy"
PSM_FIRMWARE_DEPLOY_DIR = "${TMPDIR}-emb-plus-ve2302-amr-microblaze-psm/deploy/images/${MACHINE}"

# Set the default (linux) domain device tree
CONFIG_DTFILE_DIR := "${@bb.utils.which(d.getVar('BBPATH'), 'conf/dts/emb-plus-ve2302-amr')}"
CONFIG_DTFILE ?= "${CONFIG_DTFILE_DIR}/cortexa72-linux.dts"
CONFIG_DTFILE[vardepsexclude] += "CONFIG_DTFILE_DIR"

# Yocto arm-trusted-firmware(TF-A) variables
TFA_CONSOLE ?= "pl011_1"
TFA_BL33_LOAD ?= "0x8000000"

# Set DDR Base address for u-boot-xlnx-scr variables
DDR_BASEADDR ?= "0x0"
SKIP_APPEND_BASEADDR ?= "0"

# Yocto KERNEL Variables
UBOOT_ENTRYPOINT  ?= "0x8200000"
UBOOT_LOADADDRESS ?= "0x8200000"

# Yocto MACHINE_FEATURES Variable
MACHINE_FEATURES += "vdu fpga-overlay"

# Required generic machine inclusion
require conf/machine/versal-generic.conf

# This is an 'SDT' based BSP
XILINX_WITH_ESW = "sdt"

# Original SDT artifacts URL
SDT_URI = "https://petalinux.xilinx.com/sswreleases/rel-v2025.1/sdt/2025.1.1/2025.1.1_0912_1_09120938/external/emb-plus-ve2302-amr/emb-plus-ve2302-amr_2025.1.1_0912_1_09120938.tar.gz"
SDT_URI[sha256sum] = "f2e1980c7ba1b098dc22f4a9de5536cab027913e372397a9ed006937309012c2"
SDT_URI[S] = "${WORKDIR}/emb-plus-ve2302-amr_2025.1.1_0912_1_09120938"

# Set the system device trees
SYSTEM_DTFILE_DEPENDS = "sdt-artifacts"
SYSTEM_DTFILE_DIR = "${RECIPE_SYSROOT}${datadir}/sdt/${MACHINE}"
SYSTEM_DTFILE = "${SYSTEM_DTFILE_DIR}/system-top.dts"

# Load the dynamic machine features
include conf/machine/include/emb-plus-ve2302-amr/${BB_CURRENT_MC}-features.conf
LIBXIL_CONFIG = "conf/machine/include/emb-plus-ve2302-amr/${BB_CURRENT_MC}-libxil.conf"

# Versal PDI
PDI_PATH_DEPENDS = "sdt-artifacts"
PDI_PATH_DIR = "${RECIPE_SYSROOT}${datadir}/sdt/${MACHINE}"
PDI_PATH = "${PDI_PATH_DIR}/ve2302_xdma_base.pdi"

# Update bootbin to use proper device tree
BIF_PARTITION_IMAGE[device-tree] = "${RECIPE_SYSROOT}/boot/devicetree/${@os.path.basename(d.getVar('CONFIG_DTFILE').replace('.dts', '.dtb'))}"

# Remap boot files to ensure the right device tree is listed first
IMAGE_BOOT_FILES =+ "devicetree/${@os.path.basename(d.getVar('CONFIG_DTFILE').replace('.dts', '.dtb'))}"

#### No additional settings should be after the Postamble
#### Postamble
PACKAGE_EXTRA_ARCHS:append = "${@['', ' emb_plus_ve2302_amr']['emb-plus-ve2302-amr' != '${MACHINE}']}"
```

## Yocto-PetaLinux/sources/meta-embedded-plus/conf/machine/emb-plus-ve2302-xrt.conf
```bitbake
#@TYPE: Machine
#@NAME: emb-plus-ve2302-xrt
#@DESCRIPTION: Machine configuration for the emb-plus-ve2302-xrt boards.

BBMULTICONFIG += "emb-plus-ve2302-xrt-microblaze-pmc emb-plus-ve2302-xrt-microblaze-psm"

#### Preamble
MACHINEOVERRIDES =. "${@['', 'emb-plus-ve2302-xrt:']['emb-plus-ve2302-xrt' !='${MACHINE}']}"
#### Regular settings follow
TUNEFILE[microblaze-pmc] = "conf/machine/include/emb-plus-ve2302-xrt/microblaze.inc"
TUNEFILE[microblaze-psm] = "conf/machine/include/emb-plus-ve2302-xrt/microblaze.inc"

# Platform Loader and Manager
PLM_DEPENDS = ""
PLM_MCDEPENDS = "mc::emb-plus-ve2302-xrt-microblaze-pmc:plm-firmware:do_deploy"
PLM_DEPLOY_DIR = "${TMPDIR}-emb-plus-ve2302-xrt-microblaze-pmc/deploy/images/${MACHINE}"

# PSM Firware
PSM_DEPENDS = ""
PSM_MCDEPENDS = "mc::emb-plus-ve2302-xrt-microblaze-psm:psm-firmware:do_deploy"
PSM_FIRMWARE_DEPLOY_DIR = "${TMPDIR}-emb-plus-ve2302-xrt-microblaze-psm/deploy/images/${MACHINE}"

# Set the default (linux) domain device tree
CONFIG_DTFILE_DIR := "${@bb.utils.which(d.getVar('BBPATH'), 'conf/dts/emb-plus-ve2302-xrt')}"
CONFIG_DTFILE ?= "${CONFIG_DTFILE_DIR}/cortexa72-linux.dts"
CONFIG_DTFILE[vardepsexclude] += "CONFIG_DTFILE_DIR"

# Yocto arm-trusted-firmware(TF-A) variables
TFA_CONSOLE ?= "pl011"
TFA_BL33_LOAD ?= "0x8000000"

# Set DDR Base address for u-boot-xlnx-scr variables
DDR_BASEADDR ?= "0x0"
SKIP_APPEND_BASEADDR ?= "0"

# Yocto KERNEL Variables
UBOOT_ENTRYPOINT  ?= "0x200000"
UBOOT_LOADADDRESS ?= "0x200000"

# Yocto MACHINE_FEATURES Variable
MACHINE_FEATURES += "vdu"

# Required generic machine inclusion
require conf/machine/versal-generic.conf

# This is an 'SDT' based BSP
XILINX_WITH_ESW = "sdt"

# Original SDT artifacts URL
SDT_URI = "https://petalinux.xilinx.com/sswreleases/rel-v2025.1/sdt/2025.1.1/2025.1.1_0912_1_09120938/external/emb-plus-ve2302-xrt/emb-plus-ve2302-xrt_2025.1.1_0912_1_09120938.tar.gz"
SDT_URI[sha256sum] = "ea8030f734752d353ffbfa641a5ef7184bb6a71edcfead40112b196480c57aa1"
SDT_URI[S] = "${WORKDIR}/emb-plus-ve2302-xrt_2025.1.1_0912_1_09120938"

# Set the system device trees
SYSTEM_DTFILE_DEPENDS = "sdt-artifacts"
SYSTEM_DTFILE_DIR = "${RECIPE_SYSROOT}${datadir}/sdt/${MACHINE}"
SYSTEM_DTFILE = "${SYSTEM_DTFILE_DIR}/system-top.dts"

# Load the dynamic machine features
include conf/machine/include/emb-plus-ve2302-xrt/${BB_CURRENT_MC}-features.conf
LIBXIL_CONFIG = "conf/machine/include/emb-plus-ve2302-xrt/${BB_CURRENT_MC}-libxil.conf"

# Versal PDI
PDI_PATH_DEPENDS = "sdt-artifacts"
PDI_PATH_DIR = "${RECIPE_SYSROOT}${datadir}/sdt/${MACHINE}"
PDI_PATH = "${PDI_PATH_DIR}/ve2302_pcie_qdma_base.pdi"

# Update bootbin to use proper device tree
BIF_PARTITION_IMAGE[device-tree] = "${RECIPE_SYSROOT}/boot/devicetree/${@os.path.basename(d.getVar('CONFIG_DTFILE').replace('.dts', '.dtb'))}"

# Remap boot files to ensure the right device tree is listed first
IMAGE_BOOT_FILES =+ "devicetree/${@os.path.basename(d.getVar('CONFIG_DTFILE').replace('.dts', '.dtb'))}"

#### No additional settings should be after the Postamble
#### Postamble
PACKAGE_EXTRA_ARCHS:append = "${@['', ' emb_plus_ve2302_xrt']['emb-plus-ve2302-xrt' != '${MACHINE}']}"
```

## Yocto-PetaLinux/sources/meta-embedded-plus/conf/machine/include/emb-plus-ve2302-amr/emb-plus-ve2302-amr-cortexr5-0-freertos-features.conf
```bitbake
MACHINE_FEATURES = "cframe cfupmc common coresightps-dcc csudma gpiops iicps ipipsu ospipsv rtcpsu scugic spips sysmonpsv trngpsv ttcps uartlite uartpsv zdma"
```

## Yocto-PetaLinux/sources/meta-embedded-plus/conf/machine/include/emb-plus-ve2302-amr/emb-plus-ve2302-amr-cortexr5-0-freertos-libxil.conf
```bitbake
PACKAGECONFIG[cframe] = "${RECIPE_SYSROOT}/usr/lib/libcframe.a,,cframe,,"
PACKAGECONFIG[cfupmc] = "${RECIPE_SYSROOT}/usr/lib/libcfupmc.a,,cfupmc,,"
PACKAGECONFIG[common] = "${RECIPE_SYSROOT}/usr/lib/libcommon.a,,common,,"
PACKAGECONFIG[coresightps-dcc] = "${RECIPE_SYSROOT}/usr/lib/libcoresightps_dcc.a,,coresightps-dcc,,"
PACKAGECONFIG[csudma] = "${RECIPE_SYSROOT}/usr/lib/libcsudma.a,,csudma,,"
PACKAGECONFIG[gpiops] = "${RECIPE_SYSROOT}/usr/lib/libgpiops.a,,gpiops,,"
PACKAGECONFIG[iicps] = "${RECIPE_SYSROOT}/usr/lib/libiicps.a,,iicps,,"
PACKAGECONFIG[ipipsu] = "${RECIPE_SYSROOT}/usr/lib/libipipsu.a,,ipipsu,,"
PACKAGECONFIG[ospipsv] = "${RECIPE_SYSROOT}/usr/lib/libospipsv.a,,ospipsv,,"
PACKAGECONFIG[rtcpsu] = "${RECIPE_SYSROOT}/usr/lib/librtcpsu.a,,rtcpsu,,"
PACKAGECONFIG[scugic] = "${RECIPE_SYSROOT}/usr/lib/libscugic.a,,scugic,,"
PACKAGECONFIG[spips] = "${RECIPE_SYSROOT}/usr/lib/libspips.a,,spips,,"
PACKAGECONFIG[sysmonpsv] = "${RECIPE_SYSROOT}/usr/lib/libsysmonpsv.a,,sysmonpsv,,"
PACKAGECONFIG[trngpsv] = "${RECIPE_SYSROOT}/usr/lib/libtrngpsv.a,,trngpsv,,"
PACKAGECONFIG[ttcps] = "${RECIPE_SYSROOT}/usr/lib/libttcps.a,,ttcps,,"
PACKAGECONFIG[uartlite] = "${RECIPE_SYSROOT}/usr/lib/libuartlite.a,,uartlite,,"
PACKAGECONFIG[uartpsv] = "${RECIPE_SYSROOT}/usr/lib/libuartpsv.a,,uartpsv,,"
PACKAGECONFIG[zdma] = "${RECIPE_SYSROOT}/usr/lib/libzdma.a,,zdma,,"
```

## Yocto-PetaLinux/sources/meta-embedded-plus/conf/machine/include/emb-plus-ve2302-amr/emb-plus-ve2302-amr-microblaze-pmc-features.conf
```bitbake
MACHINE_FEATURES = "cframe cfupmc common csudma gpiops iicps iomodule ipipsu ospipsv rtcpsu spips sysmonpsv tmr-inject tmr-manager trngpsv ttcps uartlite uartpsv zdma"
```

## Yocto-PetaLinux/sources/meta-embedded-plus/conf/machine/include/emb-plus-ve2302-xrt/emb-plus-ve2302-xrt-microblaze-pmc-features.conf
```bitbake
MACHINE_FEATURES = "cframe cfupmc clk-wiz common csudma gpio gpiops iicps iomodule ipipsu ospipsv rtcpsu spips sysmonpsv tmr-inject tmr-manager trngpsv ttcps uartlite uartpsv zdma"
```

## Yocto-PetaLinux/sources/meta-embedded-plus/conf/machine/include/emb-plus-ve2302-xrt/emb-plus-ve2302-xrt-microblaze-pmc-libxil.conf
```bitbake
PACKAGECONFIG[cframe] = "${RECIPE_SYSROOT}/usr/lib/libcframe.a,,cframe,,"
PACKAGECONFIG[cfupmc] = "${RECIPE_SYSROOT}/usr/lib/libcfupmc.a,,cfupmc,,"
PACKAGECONFIG[clk-wiz] = "${RECIPE_SYSROOT}/usr/lib/libclk_wiz.a,,clk-wiz,,"
PACKAGECONFIG[common] = "${RECIPE_SYSROOT}/usr/lib/libcommon.a,,common,,"
PACKAGECONFIG[csudma] = "${RECIPE_SYSROOT}/usr/lib/libcsudma.a,,csudma,,"
PACKAGECONFIG[gpio] = "${RECIPE_SYSROOT}/usr/lib/libgpio.a,,gpio,,"
PACKAGECONFIG[gpiops] = "${RECIPE_SYSROOT}/usr/lib/libgpiops.a,,gpiops,,"
PACKAGECONFIG[iicps] = "${RECIPE_SYSROOT}/usr/lib/libiicps.a,,iicps,,"
PACKAGECONFIG[iomodule] = "${RECIPE_SYSROOT}/usr/lib/libiomodule.a,,iomodule,,"
PACKAGECONFIG[ipipsu] = "${RECIPE_SYSROOT}/usr/lib/libipipsu.a,,ipipsu,,"
PACKAGECONFIG[ospipsv] = "${RECIPE_SYSROOT}/usr/lib/libospipsv.a,,ospipsv,,"
PACKAGECONFIG[rtcpsu] = "${RECIPE_SYSROOT}/usr/lib/librtcpsu.a,,rtcpsu,,"
PACKAGECONFIG[spips] = "${RECIPE_SYSROOT}/usr/lib/libspips.a,,spips,,"
PACKAGECONFIG[sysmonpsv] = "${RECIPE_SYSROOT}/usr/lib/libsysmonpsv.a,,sysmonpsv,,"
PACKAGECONFIG[tmr-inject] = "${RECIPE_SYSROOT}/usr/lib/libtmr_inject.a,,tmr-inject,,"
PACKAGECONFIG[tmr-manager] = "${RECIPE_SYSROOT}/usr/lib/libtmr_manager.a,,tmr-manager,,"
PACKAGECONFIG[trngpsv] = "${RECIPE_SYSROOT}/usr/lib/libtrngpsv.a,,trngpsv,,"
PACKAGECONFIG[ttcps] = "${RECIPE_SYSROOT}/usr/lib/libttcps.a,,ttcps,,"
PACKAGECONFIG[uartlite] = "${RECIPE_SYSROOT}/usr/lib/libuartlite.a,,uartlite,,"
PACKAGECONFIG[uartpsv] = "${RECIPE_SYSROOT}/usr/lib/libuartpsv.a,,uartpsv,,"
PACKAGECONFIG[zdma] = "${RECIPE_SYSROOT}/usr/lib/libzdma.a,,zdma,,"
```

## Yocto-PetaLinux/sources/meta-petalinux/conf/distro/include/petalinux-feed.conf
```bitbake
PACKAGE_FEED_URIS ?= "https://petalinux.xilinx.com/sswreleases/rel-v${XILINX_VER_MAIN}/generic/rpm"

# Package feed names always use '_', while ARCH names might include -
PACKAGE_FEED_ARCHS ?= "${@d.getVar('PACKAGE_ARCHS').replace('-','_')}"
```

## Yocto-PetaLinux/sources/meta-petalinux/conf/distro/include/petalinux-mirrors.conf
```bitbake
INHERIT += "own-mirrors"
SOURCE_MIRROR_URL ?= "https://petalinux.xilinx.com/sswreleases/rel-v${XILINX_VER_MAIN}/downloads"
```

## Yocto/build/conf/bblayers.conf
```bitbake
# POKY_BBLAYERS_CONF_VERSION is increased each time build/conf/bblayers.conf
# changes incompatibly
POKY_BBLAYERS_CONF_VERSION = "2"

BBPATH = "${TOPDIR}"
BBFILES ?= ""

YOCTOROOT = "${@os.path.abspath(os.path.join("${TOPDIR}", os.pardir))}"

BBLAYERS ?= " \
  ${YOCTOROOT}/sources/poky/meta \
  ${YOCTOROOT}/sources/poky/meta-poky \
  ${YOCTOROOT}/sources/poky/../meta-openembedded/meta-oe \
  ${YOCTOROOT}/sources/poky/../meta-openembedded/meta-python \
  ${YOCTOROOT}/sources/poky/../meta-openembedded/meta-filesystems \
  ${YOCTOROOT}/sources/poky/../meta-openembedded/meta-networking \
  ${YOCTOROOT}/sources/poky/../meta-openembedded/meta-multimedia \
  ${YOCTOROOT}/sources/poky/../meta-openembedded/meta-webserver \
  ${YOCTOROOT}/sources/poky/../meta-virtualization \
  ${YOCTOROOT}/sources/poky/../meta-security \
  ${YOCTOROOT}/sources/poky/../meta-security/meta-tpm \
  ${YOCTOROOT}/sources/poky/../meta-xilinx/meta-xilinx-core \
  ${YOCTOROOT}/sources/poky/../meta-xilinx/meta-xilinx-standalone \
  ${YOCTOROOT}/sources/poky/../meta-xilinx/meta-xilinx-standalone-sdt \
  ${YOCTOROOT}/sources/poky/../meta-xilinx/meta-xilinx-multimedia \
  ${YOCTOROOT}/sources/poky/../meta-xilinx/meta-xilinx-demos \
  ${YOCTOROOT}/sources/poky/../meta-xilinx/meta-xilinx-virtualization \
  ${YOCTOROOT}/sources/poky/../meta-xilinx/meta-xilinx-mali400 \
  ${YOCTOROOT}/sources/poky/../meta-xilinx/meta-xilinx-gpu-malig78ae \
  ${YOCTOROOT}/sources/poky/../meta-xilinx/meta-microblaze \
  ${YOCTOROOT}/sources/poky/../meta-xilinx/meta-amd-zephyr \
  ${YOCTOROOT}/sources/poky/../meta-xilinx-tsn \
  ${YOCTOROOT}/sources/poky/../meta-openamp \
  ${YOCTOROOT}/sources/poky/../meta-amd-edf \
  ${YOCTOROOT}/sources/poky/../meta-amd-edf/meta-amd-edf-bsp \
  ${YOCTOROOT}/sources/poky/../meta-kria \
  ${YOCTOROOT}/sources/poky/../meta-amd-adaptive-socs/meta-amd-adaptive-socs-core \
  ${YOCTOROOT}/sources/poky/../meta-amd-adaptive-socs/meta-amd-adaptive-socs-bsp \
  ${YOCTOROOT}/sources/poky/../meta-xilinx/meta-xilinx-imgrcvry \
  ${YOCTOROOT}/sources/poky/../meta-arm/meta-arm \
  ${YOCTOROOT}/sources/poky/../meta-arm/meta-arm-toolchain \
  ${YOCTOROOT}/sources/poky/../meta-jupyter \
  ${YOCTOROOT}/sources/poky/../meta-ros/meta-ros-common \
  ${YOCTOROOT}/sources/poky/../meta-ros/meta-ros2 \
  ${YOCTOROOT}/sources/poky/../meta-ros/meta-ros2-jazzy \
  ${YOCTOROOT}/sources/poky/../meta-qt5 \
  ${YOCTOROOT}/sources/poky/../meta-vitis \
  ${YOCTOROOT}/sources/poky/../meta-zephyr/meta-zephyr-core \
  ${YOCTOROOT}/sources/poky/../meta-zephyr/meta-zephyr-bsp \
  ${YOCTOROOT}/sources/poky/../meta-rauc \
  ${YOCTOROOT}/sources/poky/../meta-system-controller \
  ${YOCTOROOT}/sources/meta-custom \
  "
```
