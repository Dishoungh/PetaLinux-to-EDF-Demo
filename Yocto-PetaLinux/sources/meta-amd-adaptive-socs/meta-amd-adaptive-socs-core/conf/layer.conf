## Yocto/sources/meta-amd-adaptive-socs/meta-amd-adaptive-socs-bsp/conf/machine/include/versal-2ve-2vm-vek385-revb-sdt-seg/microblaze.inc
```bitbake
# /cpus_microblaze@0/cpu@0
#   compatible = "pmc-microblaze";
AVAILTUNES += "microblaze-pmc"
TUNE_FEATURES:tune-microblaze-pmc = "microblaze v10.0 barrel-shift pattern-compare reorder multiply-high divide-hard fpu-soft"
PACKAGE_EXTRA_ARCHS:tune-microblaze-pmc = "${TUNE_PKGARCH}"


require conf/machine/include/xilinx-microblaze.inc
```

## Yocto/sources/meta-amd-adaptive-socs/meta-amd-adaptive-socs-bsp/conf/machine/include/versal-2ve-2vm-vek385-revb-sdt-seg/versal-2ve-2vm-vek385-revb-sdt-seg-microblaze-pmc-features.conf
```bitbake
MACHINE_FEATURES = "cframe cfupmc common csudma emacps gpiops iicps iomodule ipipsu ospipsv sysmonpsv trngpsx ttcps uartpsv ufspsxc usbpsu zdma"
```

## Yocto/sources/meta-amd-adaptive-socs/meta-amd-adaptive-socs-bsp/conf/machine/include/versal-2ve-2vm-vek385-sdt-seg/versal-2ve-2vm-vek385-sdt-seg-cortexr52-1-baremetal-features.conf
```bitbake
MACHINE_FEATURES = "canfd cframe cfupmc common coresightps-dcc csudma dcsub emacps gpiops iicps ipipsu mmidp ospipsv rtcpsu scugic sysmonpsv trngpsx ttcps uartpsv ufspsxc usbpsu video-common xdmapcie zdma"
```

## Yocto/sources/meta-amd-adaptive-socs/meta-amd-adaptive-socs-bsp/conf/machine/include/versal-2ve-2vm-vek385-sdt-seg/versal-2ve-2vm-vek385-sdt-seg-cortexr52-1-baremetal-libxil.conf
```bitbake
PACKAGECONFIG[canfd] = "${RECIPE_SYSROOT}/usr/lib/libcanfd.a,,canfd,,"
PACKAGECONFIG[cframe] = "${RECIPE_SYSROOT}/usr/lib/libcframe.a,,cframe,,"
PACKAGECONFIG[cfupmc] = "${RECIPE_SYSROOT}/usr/lib/libcfupmc.a,,cfupmc,,"
PACKAGECONFIG[common] = "${RECIPE_SYSROOT}/usr/lib/libcommon.a,,common,,"
PACKAGECONFIG[coresightps-dcc] = "${RECIPE_SYSROOT}/usr/lib/libcoresightps_dcc.a,,coresightps-dcc,,"
PACKAGECONFIG[csudma] = "${RECIPE_SYSROOT}/usr/lib/libcsudma.a,,csudma,,"
PACKAGECONFIG[dcsub] = "${RECIPE_SYSROOT}/usr/lib/libdcsub.a,,dcsub,,"
PACKAGECONFIG[emacps] = "${RECIPE_SYSROOT}/usr/lib/libemacps.a,,emacps,,"
PACKAGECONFIG[gpiops] = "${RECIPE_SYSROOT}/usr/lib/libgpiops.a,,gpiops,,"
PACKAGECONFIG[iicps] = "${RECIPE_SYSROOT}/usr/lib/libiicps.a,,iicps,,"
PACKAGECONFIG[ipipsu] = "${RECIPE_SYSROOT}/usr/lib/libipipsu.a,,ipipsu,,"
PACKAGECONFIG[mmidp] = "${RECIPE_SYSROOT}/usr/lib/libmmidp.a,,mmidp,,"
PACKAGECONFIG[ospipsv] = "${RECIPE_SYSROOT}/usr/lib/libospipsv.a,,ospipsv,,"
PACKAGECONFIG[rtcpsu] = "${RECIPE_SYSROOT}/usr/lib/librtcpsu.a,,rtcpsu,,"
PACKAGECONFIG[scugic] = "${RECIPE_SYSROOT}/usr/lib/libscugic.a,,scugic,,"
PACKAGECONFIG[sysmonpsv] = "${RECIPE_SYSROOT}/usr/lib/libsysmonpsv.a,,sysmonpsv,,"
PACKAGECONFIG[trngpsx] = "${RECIPE_SYSROOT}/usr/lib/libtrngpsx.a,,trngpsx,,"
PACKAGECONFIG[ttcps] = "${RECIPE_SYSROOT}/usr/lib/libttcps.a,,ttcps,,"
PACKAGECONFIG[uartpsv] = "${RECIPE_SYSROOT}/usr/lib/libuartpsv.a,,uartpsv,,"
PACKAGECONFIG[ufspsxc] = "${RECIPE_SYSROOT}/usr/lib/libufspsxc.a,,ufspsxc,,"
PACKAGECONFIG[usbpsu] = "${RECIPE_SYSROOT}/usr/lib/libusbpsu.a,,usbpsu,,"
PACKAGECONFIG[video-common] = "${RECIPE_SYSROOT}/usr/lib/libvideo_common.a,,video-common,,"
PACKAGECONFIG[xdmapcie] = "${RECIPE_SYSROOT}/usr/lib/libxdmapcie.a,,xdmapcie,,"
PACKAGECONFIG[zdma] = "${RECIPE_SYSROOT}/usr/lib/libzdma.a,,zdma,,"
```

## Yocto/sources/meta-amd-adaptive-socs/meta-amd-adaptive-socs-bsp/conf/machine/include/versal-v80-sdt-seg/versal-v80-sdt-seg-cortexr5-0-freertos-features.conf
```bitbake
MACHINE_FEATURES = "cframe cfupmc common coresightps-dcc csudma gpiops iicps ipipsu ospipsv rtcpsu scugic sdps spips sysmonpsv trngpsv ttcps uartlite uartpsv zdma"
```

## Yocto/sources/meta-amd-adaptive-socs/meta-amd-adaptive-socs-bsp/conf/machine/include/versal-v80-sdt-seg/versal-v80-sdt-seg-microblaze-pmc-features.conf
```bitbake
MACHINE_FEATURES = "cframe cfupmc common csudma gpiops iicps iomodule ipipsu ospipsv sdps spips sysmonpsv trngpsv ttcps uartlite uartpsv zdma"
```

## Yocto/sources/meta-amd-adaptive-socs/meta-amd-adaptive-socs-bsp/conf/machine/include/versal-vck190-sdt-seg/versal-vck190-sdt-seg-microblaze-pmc-features.conf
```bitbake
MACHINE_FEATURES = "cframe cfupmc common csudma emacps gpiops iicps iomodule ipipsu qspipsu sdps sysmonpsv trngpsv ttcps uartlite uartpsv usbpsu zdma"
```

## Yocto/sources/meta-amd-adaptive-socs/meta-amd-adaptive-socs-bsp/conf/machine/include/versal-vek280-sdt-seg/versal-vek280-sdt-seg-cortexr5-0-freertos-features.conf
```bitbake
MACHINE_FEATURES = "bram canfd cframe cfupmc common coresightps-dcc csudma emacps gpio gpiops iicps ipipsu ospipsv rtcpsu scugic sdps sysmonpsv trngpsv ttcps uartlite uartns550 uartpsv usbpsu zdma"
```

## Yocto/sources/meta-amd-adaptive-socs/meta-amd-adaptive-socs-bsp/conf/machine/include/versal-vm-p-m1369-00-reva-x-prc-01-reva-sdt-seg/versal-vm-p-m1369-00-reva-x-prc-01-reva-sdt-seg-cortexr5-0-freertos-features.conf
```bitbake
MACHINE_FEATURES = "canfd cframe cfupmc common coresightps-dcc csudma emacps iicps ipipsu qspipsu rtcpsu scugic sdps sysmonpsv trngpsv ttcps uartlite uartpsv usbpsu zdma"
```

## Yocto/sources/meta-amd-adaptive-socs/meta-amd-adaptive-socs-bsp/conf/machine/include/versal-vm-p-m1369-00-reva-x-prc-01-reva-sdt-seg/versal-vm-p-m1369-00-reva-x-prc-01-reva-sdt-seg-cortexr5-0-freertos-libxil.conf
```bitbake
PACKAGECONFIG[canfd] = "${RECIPE_SYSROOT}/usr/lib/libcanfd.a,,canfd,,"
PACKAGECONFIG[cframe] = "${RECIPE_SYSROOT}/usr/lib/libcframe.a,,cframe,,"
PACKAGECONFIG[cfupmc] = "${RECIPE_SYSROOT}/usr/lib/libcfupmc.a,,cfupmc,,"
PACKAGECONFIG[common] = "${RECIPE_SYSROOT}/usr/lib/libcommon.a,,common,,"
PACKAGECONFIG[coresightps-dcc] = "${RECIPE_SYSROOT}/usr/lib/libcoresightps_dcc.a,,coresightps-dcc,,"
PACKAGECONFIG[csudma] = "${RECIPE_SYSROOT}/usr/lib/libcsudma.a,,csudma,,"
PACKAGECONFIG[emacps] = "${RECIPE_SYSROOT}/usr/lib/libemacps.a,,emacps,,"
PACKAGECONFIG[iicps] = "${RECIPE_SYSROOT}/usr/lib/libiicps.a,,iicps,,"
PACKAGECONFIG[ipipsu] = "${RECIPE_SYSROOT}/usr/lib/libipipsu.a,,ipipsu,,"
PACKAGECONFIG[qspipsu] = "${RECIPE_SYSROOT}/usr/lib/libqspipsu.a,,qspipsu,,"
PACKAGECONFIG[rtcpsu] = "${RECIPE_SYSROOT}/usr/lib/librtcpsu.a,,rtcpsu,,"
PACKAGECONFIG[scugic] = "${RECIPE_SYSROOT}/usr/lib/libscugic.a,,scugic,,"
PACKAGECONFIG[sdps] = "${RECIPE_SYSROOT}/usr/lib/libsdps.a,,sdps,,"
PACKAGECONFIG[sysmonpsv] = "${RECIPE_SYSROOT}/usr/lib/libsysmonpsv.a,,sysmonpsv,,"
PACKAGECONFIG[trngpsv] = "${RECIPE_SYSROOT}/usr/lib/libtrngpsv.a,,trngpsv,,"
PACKAGECONFIG[ttcps] = "${RECIPE_SYSROOT}/usr/lib/libttcps.a,,ttcps,,"
PACKAGECONFIG[uartlite] = "${RECIPE_SYSROOT}/usr/lib/libuartlite.a,,uartlite,,"
PACKAGECONFIG[uartpsv] = "${RECIPE_SYSROOT}/usr/lib/libuartpsv.a,,uartpsv,,"
PACKAGECONFIG[usbpsu] = "${RECIPE_SYSROOT}/usr/lib/libusbpsu.a,,usbpsu,,"
PACKAGECONFIG[zdma] = "${RECIPE_SYSROOT}/usr/lib/libzdma.a,,zdma,,"
```

## Yocto/sources/meta-amd-adaptive-socs/meta-amd-adaptive-socs-bsp/conf/machine/include/versal-vm-p-m1369-00-reva-x-prc-01-reva-sdt-seg/versal-vm-p-m1369-00-reva-x-prc-01-reva-sdt-seg-microblaze-pmc-features.conf
```bitbake
MACHINE_FEATURES = "cframe cfupmc common csudma emacps iicps iomodule ipipsu qspipsu sdps sysmonpsv trngpsv ttcps uartlite uartpsv usbpsu zdma"
```

## Yocto/sources/meta-amd-adaptive-socs/meta-amd-adaptive-socs-bsp/conf/machine/include/versal-vm-p-m1369-00-reva-x-prc-01-reva-sdt-seg/versal-vm-p-m1369-00-reva-x-prc-01-reva-sdt-seg-microblaze-psm-features.conf
```bitbake
MACHINE_FEATURES = "canfd cframe cfupmc common csudma emacps iicps iomodule ipipsu qspipsu rtcpsu sdps sysmonpsv tmr-inject tmr-manager trngpsv ttcps uartlite uartpsv usbpsu zdma"
```

## Yocto/sources/meta-amd-adaptive-socs/meta-amd-adaptive-socs-bsp/conf/machine/include/versal-vmk180-sdt-seg/versal-vmk180-sdt-seg-cortexr5-0-freertos-features.conf
```bitbake
MACHINE_FEATURES = "bram canfd cframe cfupmc common coresightps-dcc csudma emacps gpio gpiops iicps ipipsu qspipsu rtcpsu scugic sdps sysmonpsv trngpsv ttcps uartlite uartpsv usbpsu zdma"
```
