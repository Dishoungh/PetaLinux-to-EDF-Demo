## Yocto/sources/meta-system-controller/conf/machine/include/zynqmp-k24-sc-sdt-base/zynqmp-k24-sc-sdt-base-microblaze-pmu-features.conf
```bitbake
MACHINE_FEATURES = "axipmon clockps common csudma ddrcpsu emacps gpiops iicps ipipsu qspipsu resetps rtcpsu sdps spips sysmonpsu ttcps uartps usbpsu wdtps zdma"
```

## Yocto/sources/meta-system-controller/conf/machine/system-controller-generic.conf
```bitbake
MACHINEOVERRIDES =. "system-controller:"

IMAGE_FSTYPES += "wic wic.xz"
IMAGE_FSTYPES:append:system-controller-rauc-demo = " ext4"

# Enable initramfs image to switch to full root file system
INITRAMFS_IMAGE ?= "petalinux-initramfs-image"
INITRAMFS_FSTYPES ?= "cpio.gz cpio.gz.u-boot tar.gz"
RAMDISK_IMAGE1 = "${INITRAMFS_IMAGE}-${MACHINE}.cpio.gz.u-boot"

# Required generic machine inclusion
require conf/machine/zynqmp-generic.conf

# Add the following files to /boot
IMAGE_BOOT_FILES = "Image ${INITRAMFS_IMAGE}-${MACHINE}.cpio.gz.u-boot boot.scr"

# rauc
SYSTEM_CONTROLLER_RAUC_DEMO ?= "no"
OVERRIDES .= "${@ ':system-controller-rauc-demo' if bb.utils.to_boolean(d.getVar('SYSTEM_CONTROLLER_RAUC_DEMO'), False) else ''}"

# Default values for deploy dirs
FSBL_DEPLOY_DIR ??= "${DEPLOY_DIR_IMAGE}"
PMU_FIRMWARE_DEPLOY_DIR ??= "${DEPLOY_DIR_IMAGE}"
```

## Yocto/sources/meta-system-controller/conf/machine/zynqmp-k24-sc-sdt-base.conf
```bitbake
#@TYPE: Machine
#@NAME: zynqmp-k24-sc-sdt-base
#@DESCRIPTION: Machine configuration for the zynqmp-k24-sc-sdt-base boards.


BBMULTICONFIG += "zynqmp-k24-sc-sdt-base-cortexa53-fsbl zynqmp-k24-sc-sdt-base-microblaze-pmu"

#### Preamble
MACHINEOVERRIDES =. "${@['', 'zynqmp-k24-sc-sdt-base:']['zynqmp-k24-sc-sdt-base' !='${MACHINE}']}"
#### Regular settings follow
TUNEFILE[microblaze-pmu] = "conf/machine/include/zynqmp-k24-sc-sdt-base/microblaze.inc"

# First Stage Boot Loader
FSBL_DEPENDS = ""
FSBL_MCDEPENDS = "mc::zynqmp-k24-sc-sdt-base-cortexa53-fsbl:fsbl-firmware:do_deploy"
FSBL_DEPLOY_DIR = "${TMPDIR}-zynqmp-k24-sc-sdt-base-cortexa53-fsbl/deploy/images/${MACHINE}"

# PMU Firware
PMU_DEPENDS = ""
PMU_MCDEPENDS = "mc::zynqmp-k24-sc-sdt-base-microblaze-pmu:pmu-firmware:do_deploy"
PMU_FIRMWARE_DEPLOY_DIR = "${TMPDIR}-zynqmp-k24-sc-sdt-base-microblaze-pmu/deploy/images/${MACHINE}"

# Set the default (linux) domain device tree
CONFIG_DTFILE_DIR := "${@bb.utils.which(d.getVar('BBPATH'), 'conf/dts/zynqmp-k24-sc-sdt-base')}"
CONFIG_DTFILE ?= "${CONFIG_DTFILE_DIR}/cortexa53-linux.dts"
CONFIG_DTFILE[vardepsexclude] += "CONFIG_DTFILE_DIR"

# Yocto arm-trusted-firmware(TF-A) variables
TFA_CONSOLE ?= "cadence"
TFA_BL33_LOAD ?= "0x8000000"

# Set DDR Base address for u-boot-xlnx-scr variables
DDR_BASEADDR ?= "0x0"
SKIP_APPEND_BASEADDR ?= "0"

# Yocto KERNEL Variables
UBOOT_ENTRYPOINT  ?= "0x200000"
UBOOT_LOADADDRESS ?= "0x200000"

# Yocto MACHINE_FEATURES Variable
MACHINE_FEATURES += "mali400 fpga-overlay"

# Required generic machine inclusion
require conf/machine/zynqmp-generic.conf

# Enable meta-xilinx-imgrcvry if available
include conf/enable-xilinx-imgrcvry.conf
# This prevents inclusion of XEN dtsi into system.dtb
ENABLE_XEN_DTSI:zynqmp-k24-sc-sdt-base = ""
ENABLE_XEN_QEMU_DTSI:zynqmp-k24-sc-sdt-base = ""

# This is an 'SDT' based BSP
XILINX_WITH_ESW = "sdt"

# Original SDT artifacts URL
SDT_URI = "https://edf.amd.com/sswreleases/rel-v2025.2/sdt/2025.2/2025.2_1115_1_11150857/external/zynqmp-k24-sc-sdt-base/zynqmp-k24-sc-sdt-base_2025.2_1115_1_11150857.tar.gz"
SDT_URI[sha256sum] = "81e499e5030e12907fe1f1c3ac6254b56fbb0adf831deb779846e63a0062f6bd"
SDT_URI[S] = "${WORKDIR}/zynqmp-k24-sc-sdt-base_2025.2_1115_1_11150857"

# Set the system device trees
SYSTEM_DTFILE_DEPENDS = "sdt-artifacts"
SYSTEM_DTFILE_DIR = "${RECIPE_SYSROOT}${datadir}/sdt/${MACHINE}"
SYSTEM_DTFILE = "${SYSTEM_DTFILE_DIR}/system-top.dts"

# Load the dynamic machine features
include conf/machine/include/zynqmp-k24-sc-sdt-base/${BB_CURRENT_MC}-features.conf
LIBXIL_CONFIG = "conf/machine/include/zynqmp-k24-sc-sdt-base/${BB_CURRENT_MC}-libxil.conf"

# Update bootbin to use proper device tree
BIF_PARTITION_IMAGE[device-tree] = "${RECIPE_SYSROOT}/boot/devicetree/${@os.path.basename(d.getVar('CONFIG_DTFILE').replace('.dts', '.dtb'))}"

# Remap boot files to ensure the right device tree is listed first
IMAGE_BOOT_FILES =+ "devicetree/${@os.path.basename(d.getVar('CONFIG_DTFILE').replace('.dts', '.dtb'))}"

#### No additional settings should be after the Postamble
#### Postamble
PACKAGE_EXTRA_ARCHS:append = "${@['', ' zynqmp_k24_sc_sdt_base']['zynqmp-k24-sc-sdt-base' != '${MACHINE}']}"
```

## Yocto/sources/meta-system-controller/wic/system-controller-nobootpartition.wks
```
part  /  --source rootfs  --fstype=ext4  --part-name rootfsA  --use-label  --label rootfsA  --active  --align 4  --part-type b921b045-1df0-41c3-af44-4c6f280d3fae

bootloader  --ptable gpt
```

## Yocto/sources/meta-xilinx/meta-amd-zephyr/conf/machine/xenvmgicv3.conf
```bitbake
#@TYPE: Machine
#@NAME: xenvmgicv3
#@DESCRIPTION: Machine for Zephyr BOARD xenvm gicv3

# Include tune-cortexa72-cortexa53.inc
require conf/machine/include/arm/armv8a/tune-cortexa72-cortexa53.inc

DEFAULTTUNE = "cortexa72-cortexa53"

# Zephyr RTOS settings
ZEPHYR_BOARD = "xenvm/xenvm/gicv3"
ARCH:xenvm = "aarch64"
DISTRO = "amd-zephyr"
```

## Yocto/sources/meta-xilinx/meta-xilinx-bsp/conf/layer.conf
```bitbake
# We have a conf and classes directory, add to BBPATH
BBPATH .= ":${LAYERDIR}"

# We have a packages directory, add to BBFILES
BBFILES += "${LAYERDIR}/recipes-*/*/*.bb"
BBFILES += "${LAYERDIR}/recipes-*/*/*.bbappend"

BBFILE_COLLECTIONS += "xilinx-bsp"
BBFILE_PATTERN_xilinx-bsp = "^${LAYERDIR}/"
BBFILE_PRIORITY_xilinx-bsp = "5"
BBFILE_PATTERN_IGNORE_EMPTY_xilinx-bsp = "1"

LAYERDEPENDS_xilinx-bsp = "xilinx"

LAYERSERIES_COMPAT_xilinx-bsp = "scarthgap"
```

## Yocto/sources/meta-xilinx/meta-xilinx-core/conf/machine/include/soc-microblaze-v.inc
```bitbake
DEFAULTTUNE ?= "microblaze-v"
SOC_FAMILY ?= "microblaze-v"

require conf/machine/include/soc-family.inc
require soc-tune-include.inc

# Linux Configuration
KERNEL_IMAGETYPE ?= "Image"
KERNEL_IMAGETYPES += "uImage"
KEEPUIMAGE = "no"

UBOOT_ELF ?= "u-boot"
```

## Yocto/sources/meta-xilinx/meta-xilinx-core/conf/machine/microblaze-v-generic.conf
```bitbake
#@TYPE: Machine
#@NAME: microblaze-v-generic
#@DESCRIPTION: Machine configuration for the microblaze-v-generic devices

#### Preamble
MACHINEOVERRIDES =. "${@['', 'microblaze-v-generic:']['microblaze-v-generic' != '${MACHINE}']}"
#### Regular settings follow

# Set the default for a modern full feature (32-bit) microblaze-v...
# Note, glibc does not support 'f' without 'd'
TUNE_FEATURES:tune-microblaze-v ?= "${@mbv.tune.riscv_isa_to_tune("rv32imac_zicbom_zicsr_zifencei_zba_zbb_zbs")}"

# Variables that changes based on hw design or board specific requirement must be
# defined before calling the required inclusion file else pre-expansion value
# defined in local.conf without machine override will not be reflected.

# Currently does not build with linux-xlnx, use linux-yocto instead
PREFERRED_PROVIDER_virtual/kernel ?= "linux-yocto"

PREFERRED_VERSION_openocd-native = "riscv"
PREFERRED_VERSION_openocd = "riscv"

XVISOR_PLAT:riscv32 = "riscv/virt32"
XVISOR_PLAT:riscv64 = "riscv/virt64"

UBOOT_BOOT_SCRIPT ??= ""
UBOOT_MACHINE:riscv32 = "qemu-riscv32_smode_defconfig"
UBOOT_MACHINE:riscv64 = "qemu-riscv64_smode_defconfig"

require conf/machine/include/soc-microblaze-v.inc
require conf/machine/include/machine-xilinx-default.inc
require conf/machine/include/machine-xilinx-qemu.inc

# qemu-xilinx, in riscv64 mode may just exist when USB is initialized
PREFERRED_PROVIDER_qemu-native = "qemu-native"
PREFERRED_PROVIDER_qemu-system-native = "qemu-system-native"

MACHINE_FEATURES += "keyboard ext2 ext3 serial"

SERIAL_CONSOLES ?= "115200;ttyS0 115200;hvc0"

IMAGE_FSTYPES += "ext4 wic.qcow2"

IMAGE_CLASSES += "image-types-xilinx-qemu"
# Add wic.qemu-sd only if initramfs_image not set due to circular dependecies
IMAGE_FSTYPES += "${@'wic.qemu-sd' if (d.getVar('INITRAMFS_IMAGE') or '') == '' else 'cpio.gz'}"

MACHINE_EXTRA_RRECOMMENDS += " kernel-modules"

EXTRA_IMAGEDEPENDS += "opensbi"
RISCV_SBI_PLAT ?= "generic"
RISCV_SBI_PAYLOAD ?= "${KERNEL_IMAGETYPE}-${MACHINE}.bin"

UBOOT_ENTRYPOINT:riscv32 = "0x80400000"
UBOOT_ENTRYPOINT:riscv64 = "0x80200000"

# The default MACHINE_ARCH is dynamic for microblaze-v, since the architecture is not fixed
MACHINE_ARCH_ORIG := "${MACHINE_ARCH}"
MACHINE_ARCH_DYN := "microblaze_${TUNE_RISCV_PKGARCH}_generic"

MACHINE_ARCH = "${@['${MACHINE_ARCH_DYN}', '${MACHINE_ARCH_ORIG}']['microblaze-v-generic' != "${MACHINE}"]}"

# qemuboot options, based on qemuriscv
# Currently microblaze-v is only single thread
#QB_SMP ?= "-smp 4"
QB_KERNEL_CMDLINE_APPEND = "earlycon=sbi"
QB_MACHINE = "-machine virt"
QB_DEFAULT_BIOS = "fw_jump.elf"
QB_TAP_OPT = "-netdev tap,id=net0,ifname=@TAP@,script=no,downscript=no"
QB_NETWORK_DEVICE = "-device virtio-net-device,netdev=net0,mac=@MAC@"
QB_ROOTFS_OPT = "-drive id=disk0,file=@ROOTFS@,if=none,format=raw -device virtio-blk-device,drive=disk0"
QB_SERIAL_OPT = "-device virtio-serial-device -chardev null,id=virtcon -device virtconsole,chardev=virtcon"
QB_TCPSERIAL_OPT = " -device virtio-serial-device -chardev socket,id=virtcon,port=@PORT@,host=127.0.0.1,nodelay=on -device virtconsole,chardev=virtcon"
# Graphics are not supported
#QB_GRAPHICS = "-device bochs-display"

# Default when using wic.qemu-sd
QB_KERNEL_ROOT ??= "/dev/vda2"

QB_OPT_APPEND = "${RV_QEMU_ISA} -device qemu-xhci -device usb-tablet -device usb-kbd"
QB_OPT_APPEND:riscv32 = "${RV_QEMU_ISA} -device virtio-tablet-pci -device virtio-keyboard-pci"

RV_QEMU_ISA = "-cpu "
# Choose rv32 or rv64
RV_QEMU_ISA .= "${@bb.utils.contains("TUNE_FEATURES", "rv 32", "rv32", "", d)}"
RV_QEMU_ISA .= "${@bb.utils.contains("TUNE_FEATURES", "rv 64", "rv64", "", d)}"
# Disable all of the default extensions we don't want
RV_QEMU_ISA .= ",zihintntl=false,zihintpause=false,zawrs=false,zfa=false,svadu=false,zicntr=false,zihpm=false,zicboz=false,sstc=false,h=false"
# Dynamically enable the extensions based on TUNE_FEATURES
RV_QEMU_ISA .= "${@bb.utils.contains    ("TUNE_FEATURES", "m",         ",m=true",        ",m=false",        d)}"
RV_QEMU_ISA .= "${@bb.utils.contains    ("TUNE_FEATURES", "a",         ",a=true",        ",a=false",        d)}"
RV_QEMU_ISA .= "${@bb.utils.contains_any("TUNE_FEATURES", "f d",       ",f=true",        ",f=false",        d)}"
RV_QEMU_ISA .= "${@bb.utils.contains    ("TUNE_FEATURES", "d",         ",d=true",        ",d=false",        d)}"
RV_QEMU_ISA .= "${@bb.utils.contains    ("TUNE_FEATURES", "c",         ",c=true",        ",c=false",        d)}"
RV_QEMU_ISA .= "${@bb.utils.contains    ("TUNE_FEATURES", "v",         ",v=true",        ",v=false",        d)}"
RV_QEMU_ISA .= "${@bb.utils.contains    ("TUNE_FEATURES", "zicbom",    ",zicbom=true",   ",zicbom=false",   d)}"
RV_QEMU_ISA .= "${@bb.utils.contains_any("TUNE_FEATURES", "zicsr f d", ",zicsr=true",    ",zicsr=false",    d)}"
RV_QEMU_ISA .= "${@bb.utils.contains    ("TUNE_FEATURES", "zifencei",  ",zifencei=true", ",zifencei=false", d)}"
RV_QEMU_ISA .= "${@bb.utils.contains_any("TUNE_FEATURES", "b zba",     ",zba=true",      ",zba=false",      d)}"
RV_QEMU_ISA .= "${@bb.utils.contains_any("TUNE_FEATURES", "b zbb",     ",zbb=true",      ",zbb=false",      d)}"
RV_QEMU_ISA .= "${@bb.utils.contains    ("TUNE_FEATURES", "zbc",       ",zbc=true",      ",zbc=false",      d)}"
RV_QEMU_ISA .= "${@bb.utils.contains_any("TUNE_FEATURES", "b zbs",     ",zbs=true",      ",zbs=false",      d)}"

#### No additional settings should be after the Postamble
#### Postamble
PACKAGE_EXTRA_ARCHS:append = "${@['', ' microblaze_v_generic']['microblaze-v-generic' != "${MACHINE}"]}"
```

## Yocto/sources/meta-xilinx/meta-xilinx-imgrcvry/conf/distro/xilinx-image-recovery.conf
```bitbake
require conf/distro/poky-tiny.conf

DISTRO = "xilinx-image-recovery"
DISTRO_NAME = "Image Recovery Distribution Configuration"

DISTRO_VERSION = "1.0"

DISTROOVERRIDES .= ":imgrcvry"

SDK_VENDOR = "-imgrcvrysdk"

MAINTAINER = "AMD AECG <meta-xilinx@yoctoproject.org>"

TARGET_VENDOR = "-imgrcvry"

PREFERRED_PROVIDER_virtual/kernel = "linux-xlnx-imgrcvry"
PREFERRED_PROVIDER_virtual/bootloader = "u-boot-xlnx-imgrcvry"

# Keeping below variables in distro file to not impact other distro
KERNEL_IMAGETYPES += "Image.gz"

MACHINE_FEATURES:remove = "optee"

IMAGE_BOOT_FILES:aarch64 = ""
EXTRA_IMAGEDEPENDS:aarch64 = ""
```
