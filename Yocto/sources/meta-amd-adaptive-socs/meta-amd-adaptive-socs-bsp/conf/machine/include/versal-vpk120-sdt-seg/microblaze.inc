## Yocto/sources/meta-amd-adaptive-socs/meta-amd-adaptive-socs-bsp/conf/machine/include/versal-vpk120-sdt-seg/microblaze.inc
```bitbake
# /cpus_microblaze@0/cpu@0
#   compatible = "pmc-microblaze";
AVAILTUNES += "microblaze-pmc"
TUNE_FEATURES:tune-microblaze-pmc = "microblaze v10.0 barrel-shift pattern-compare reorder multiply-high divide-hard fpu-soft"
PACKAGE_EXTRA_ARCHS:tune-microblaze-pmc = "${TUNE_PKGARCH}"

# /cpus_microblaze@1/cpu@0
#   compatible = "psm-microblaze";
AVAILTUNES += "microblaze-psm"
TUNE_FEATURES:tune-microblaze-psm = "microblaze v10.0 barrel-shift pattern-compare reorder multiply-high divide-hard fpu-soft"
PACKAGE_EXTRA_ARCHS:tune-microblaze-psm = "${TUNE_PKGARCH}"


require conf/machine/include/xilinx-microblaze.inc
```

## Yocto/sources/meta-amd-adaptive-socs/meta-amd-adaptive-socs-bsp/conf/machine/include/versal-vpk120-sdt-seg/versal-vpk120-sdt-seg-microblaze-psm-libxil.conf
```bitbake
PACKAGECONFIG[bram] = "${RECIPE_SYSROOT}/usr/lib/libbram.a,,bram,,"
PACKAGECONFIG[cframe] = "${RECIPE_SYSROOT}/usr/lib/libcframe.a,,cframe,,"
PACKAGECONFIG[cfupmc] = "${RECIPE_SYSROOT}/usr/lib/libcfupmc.a,,cfupmc,,"
PACKAGECONFIG[common] = "${RECIPE_SYSROOT}/usr/lib/libcommon.a,,common,,"
PACKAGECONFIG[csudma] = "${RECIPE_SYSROOT}/usr/lib/libcsudma.a,,csudma,,"
PACKAGECONFIG[emacps] = "${RECIPE_SYSROOT}/usr/lib/libemacps.a,,emacps,,"
PACKAGECONFIG[gpio] = "${RECIPE_SYSROOT}/usr/lib/libgpio.a,,gpio,,"
PACKAGECONFIG[gpiops] = "${RECIPE_SYSROOT}/usr/lib/libgpiops.a,,gpiops,,"
PACKAGECONFIG[iicps] = "${RECIPE_SYSROOT}/usr/lib/libiicps.a,,iicps,,"
PACKAGECONFIG[iomodule] = "${RECIPE_SYSROOT}/usr/lib/libiomodule.a,,iomodule,,"
PACKAGECONFIG[ipipsu] = "${RECIPE_SYSROOT}/usr/lib/libipipsu.a,,ipipsu,,"
PACKAGECONFIG[qspipsu] = "${RECIPE_SYSROOT}/usr/lib/libqspipsu.a,,qspipsu,,"
PACKAGECONFIG[rtcpsu] = "${RECIPE_SYSROOT}/usr/lib/librtcpsu.a,,rtcpsu,,"
PACKAGECONFIG[sdps] = "${RECIPE_SYSROOT}/usr/lib/libsdps.a,,sdps,,"
PACKAGECONFIG[sysmonpsv] = "${RECIPE_SYSROOT}/usr/lib/libsysmonpsv.a,,sysmonpsv,,"
PACKAGECONFIG[tmr-inject] = "${RECIPE_SYSROOT}/usr/lib/libtmr_inject.a,,tmr-inject,,"
PACKAGECONFIG[tmr-manager] = "${RECIPE_SYSROOT}/usr/lib/libtmr_manager.a,,tmr-manager,,"
PACKAGECONFIG[trngpsv] = "${RECIPE_SYSROOT}/usr/lib/libtrngpsv.a,,trngpsv,,"
PACKAGECONFIG[ttcps] = "${RECIPE_SYSROOT}/usr/lib/libttcps.a,,ttcps,,"
PACKAGECONFIG[uartlite] = "${RECIPE_SYSROOT}/usr/lib/libuartlite.a,,uartlite,,"
PACKAGECONFIG[uartpsv] = "${RECIPE_SYSROOT}/usr/lib/libuartpsv.a,,uartpsv,,"
PACKAGECONFIG[usbpsu] = "${RECIPE_SYSROOT}/usr/lib/libusbpsu.a,,usbpsu,,"
PACKAGECONFIG[zdma] = "${RECIPE_SYSROOT}/usr/lib/libzdma.a,,zdma,,"
```

## Yocto/sources/meta-amd-adaptive-socs/meta-amd-adaptive-socs-bsp/conf/machine/include/versal-vrk160-sdt-seg/versal-vrk160-sdt-seg-microblaze-psm-features.conf
```bitbake
MACHINE_FEATURES = "bram cframe cfupmc common csudma emacps gpio gpiops iicps iomodule ipipsu ospipsv rtcpsu sdps sysmonpsv tmr-inject tmr-manager trngpsv ttcps uartlite uartns550 uartpsv usbpsu zdma"
```

## Yocto/sources/meta-amd-adaptive-socs/meta-amd-adaptive-socs-bsp/conf/machine/include/zynq-zc702-sdt-full/zynq-zc702-sdt-full-cortexa9-fsbl-features.conf
```bitbake
MACHINE_FEATURES = "bram canps common coresightps-dcc devcfg dmaps emacps gpio gpiops iicps qspips scugic scutimer scuwdt sdps ttcps uartps usbps xadcps"
```

## Yocto/sources/meta-amd-adaptive-socs/meta-amd-adaptive-socs-bsp/conf/machine/include/zynqmp-zcu102-sdt-full/zynqmp-zcu102-sdt-full-cortexa53-fsbl-features.conf
```bitbake
MACHINE_FEATURES = "avbuf axipmon bram canps clockps common coresightps-dcc csudma ddrcpsu dpdma dppsu emacps gpio gpiops iicps ipipsu pciepsu qspipsu resetps rtcpsu scugic sdps sysmonpsu ttcps uartps usbpsu video-common wdtps zdma"
```

## Yocto/sources/meta-amd-adaptive-socs/meta-amd-adaptive-socs-bsp/conf/machine/include/zynqmp-zcu111-sdt-full/zynqmp-zcu111-sdt-full-microblaze-pmu-features.conf
```bitbake
MACHINE_FEATURES = "avbuf axipmon bram clockps common csudma ddrcpsu dpdma dppsu emacps gpio gpiops iicps ipipsu qspipsu resetps rtcpsu sdps sysmonpsu ttcps uartps usbpsu video-common wdtps zdma"
```

## Yocto/sources/meta-amd-adaptive-socs/meta-amd-adaptive-socs-bsp/conf/machine/qemu-microblaze-v-32.conf
```bitbake
#@TYPE: Machine
#@NAME: qemu Microblaze-V riscv32 machine
#@DESCRIPTION: Machine configuration for running a generic riscv32

#### Preamble
MACHINEOVERRIDES =. "${@['', 'qemu-microblaze-v-32:']['qemu-microblaze-v-32' != '${MACHINE}']}"
#### Regular settings follow

# Set the default for a modern full feature (32-bit) microblaze-v...
# Note, glibc does not support 'f' without 'd'
TUNE_FEATURES:tune-microblaze-v = "${@mbv.tune.riscv_isa_to_tune("rv32imac_zicbom_zicsr_zifencei_zba_zbb_zbs")}"

# Required generic machine inclusion
require conf/machine/microblaze-v-generic.conf

# This is NOT a true 'SDT" based BSP
XILINX_WITH_ESW = ""

#### No additional settings should be after the Postamble
#### Postamble
PACKAGE_EXTRA_ARCHS:append = "${@['', ' qemu_microblaze_v_32']['qemu-microblaze-v-32' != "${MACHINE}"]}"
```

## Yocto/sources/meta-amd-adaptive-socs/meta-amd-adaptive-socs-bsp/conf/machine/qemu-microblaze-v-64.conf
```bitbake
#@TYPE: Machine
#@NAME: qemu Microblaze-V riscv64 machine
#@DESCRIPTION: Machine configuration for running a generic riscv64

#### Preamble
MACHINEOVERRIDES =. "${@['', 'qemu-microblaze-v-64:']['qemu-microblaze-v-64' != '${MACHINE}']}"
#### Regular settings follow

# Set the default for a modern full feature (64-bit) microblaze-v...
TUNE_FEATURES:tune-microblaze-v = "${@mbv.tune.riscv_isa_to_tune("rv64imafdc_zicbom_zicsr_zifencei_zba_zbb_zbs")}"

# Required generic machine inclusion
require conf/machine/microblaze-v-generic.conf

# This is NOT a true 'SDT" based BSP
XILINX_WITH_ESW = ""

#### No additional settings should be after the Postamble
#### Postamble
PACKAGE_EXTRA_ARCHS:append = "${@['', ' qemu_microblaze_v_64']['qemu-microblaze-v-64' != "${MACHINE}"]}"
```

## Yocto/sources/meta-amd-adaptive-socs/meta-amd-adaptive-socs-bsp/conf/machine/versal-2ve-2vm-vek385-sdt-seg.conf
```bitbake
#@TYPE: Machine
#@NAME: versal-2ve-2vm-vek385-sdt-seg
#@DESCRIPTION: Machine configuration for the versal-2ve-2vm-vek385-sdt-seg boards.


BBMULTICONFIG += "versal-2ve-2vm-vek385-sdt-seg-cortexr52-0-zephyr versal-2ve-2vm-vek385-sdt-seg-cortexr52-1-baremetal versal-2ve-2vm-vek385-sdt-seg-microblaze-pmc"

#### Preamble
MACHINEOVERRIDES =. "${@['', 'versal-2ve-2vm-vek385-sdt-seg:']['versal-2ve-2vm-vek385-sdt-seg' !='${MACHINE}']}"
#### Regular settings follow
TUNEFILE[microblaze-pmc] = "conf/machine/include/versal-2ve-2vm-vek385-sdt-seg/microblaze.inc"

# Platform Loader and Manager
PLM_DEPENDS = ""
PLM_MCDEPENDS = "mc::versal-2ve-2vm-vek385-sdt-seg-microblaze-pmc:plm-firmware:do_deploy"
PLM_DEPLOY_DIR = "${TMPDIR}-versal-2ve-2vm-vek385-sdt-seg-microblaze-pmc/deploy/images/${MACHINE}"

# Set the default (linux) domain device tree
CONFIG_DTFILE_DIR := "${@bb.utils.which(d.getVar('BBPATH'), 'conf/dts/versal-2ve-2vm-vek385-sdt-seg')}"
CONFIG_DTFILE ?= "${CONFIG_DTFILE_DIR}/cortexa78-linux.dts"
CONFIG_DTFILE[vardepsexclude] += "CONFIG_DTFILE_DIR"

# Yocto arm-trusted-firmware(TF-A) variables
TFA_CONSOLE ?= "pl011_1"
ATF_MEM_BASE ?= "0x1600000"
ATF_MEM_SIZE ?= "0x200000"
TFA_BL33_LOAD ?= "0x40000000"

# Yocto OP-TEE variables
OPTEE_CONSOLE ?= "1"

# Set DDR Base address for u-boot-xlnx-scr variables
DDR_BASEADDR ?= "0x0"
SKIP_APPEND_BASEADDR ?= "1"

# Yocto KERNEL Variables
UBOOT_ENTRYPOINT ?= "0x20200000"
UBOOT_LOADADDRESS ?= "0x20200000"

# Yocto MACHINE_FEATURES Variable
MACHINE_FEATURES += "vcu2 malig78ae  optee fpga-overlay"

# Required generic machine inclusion
require conf/machine/versal-2ve-2vm-generic.conf

# Enable meta-xilinx-imgrcvry if available
include conf/enable-xilinx-imgrcvry.conf
QEMU_HW_DTB_PS = "${QEMU_HW_DTB_PATH}/board-versal2-psxc-vek385.dtb"
QEMU_HW_BOOT_MODE = "8"
QEMU_HW_SERIAL = "-serial null -serial null -serial null -serial mon:stdio"
QEMU_HW_OSPI_FILE = "qemu-ospi-${MACHINE}.bin"
QB_OPT_APPEND:append := " -drive file=@DEPLOY_DIR_IMAGE@/${QEMU_HW_OSPI_FILE},if=mtd,format=raw,index=0"
QB_DEFAULT_FSTYPE = "wic.ufs"
QB_ROOTFS_OPT = "-device scsi-hd,drive=d1,bus=scsi.0,channel=0,scsi-id=0,lun=0,logical_block_size=4096,physical_block_size=4096 -drive file=@ROOTFS@,if=none,id=d1,format=raw"

# This is an 'SDT' based BSP
XILINX_WITH_ESW = "sdt"

# Original SDT artifacts URL
SDT_URI = "https://edf.amd.com/sswreleases/rel-v2025.2/sdt/2025.2/2025.2_1115_1_11150857/external/versal-2ve-2vm-vek385-sdt-seg/versal-2ve-2vm-vek385-sdt-seg_2025.2_1115_1_11150857.tar.gz"
SDT_URI[sha256sum] = "6adc33bf08f088176862c1be626e45284edaa9da88bdef3a1557c0869075a234"
SDT_URI[S] = "${WORKDIR}/versal-2ve-2vm-vek385-sdt-seg_2025.2_1115_1_11150857"

# Set the system device trees
SYSTEM_DTFILE_DEPENDS = "sdt-artifacts"
SYSTEM_DTFILE_DIR = "${RECIPE_SYSROOT}${datadir}/sdt/${MACHINE}"
SYSTEM_DTFILE = "${SYSTEM_DTFILE_DIR}/system-top.dts"

# Load the dynamic machine features
include conf/machine/include/versal-2ve-2vm-vek385-sdt-seg/${BB_CURRENT_MC}-features.conf
LIBXIL_CONFIG = "conf/machine/include/versal-2ve-2vm-vek385-sdt-seg/${BB_CURRENT_MC}-libxil.conf"

# Versal PDI
PDI_PATH_DEPENDS = "sdt-artifacts"
PDI_PATH_DIR = "${RECIPE_SYSROOT}${datadir}/sdt/${MACHINE}"
PDI_PATH = "${PDI_PATH_DIR}/vek385_base_boot.pdi"

# Update bootbin to use proper device tree
BIF_PARTITION_IMAGE[device-tree] = "${RECIPE_SYSROOT}/boot/devicetree/${@os.path.basename(d.getVar('CONFIG_DTFILE').replace('.dts', '.dtb'))}"

# Remap boot files to ensure the right device tree is listed first
IMAGE_BOOT_FILES =+ "devicetree/${@os.path.basename(d.getVar('CONFIG_DTFILE').replace('.dts', '.dtb'))}"

#### No additional settings should be after the Postamble
#### Postamble
PACKAGE_EXTRA_ARCHS:append = "${@['', ' versal_2ve_2vm_vek385_sdt_seg']['versal-2ve-2vm-vek385-sdt-seg' != '${MACHINE}']}"
```

## Yocto/sources/meta-amd-adaptive-socs/meta-amd-adaptive-socs-bsp/conf/machine/versal-vek280-sdt-seg.conf
```bitbake
#@TYPE: Machine
#@NAME: versal-vek280-sdt-seg
#@DESCRIPTION: Machine configuration for the versal-vek280-sdt-seg boards.


BBMULTICONFIG += "versal-vek280-sdt-seg-microblaze-pmc versal-vek280-sdt-seg-microblaze-psm versal-vek280-sdt-seg-cortexr5-0-freertos"

#### Preamble
MACHINEOVERRIDES =. "${@['', 'versal-vek280-sdt-seg:']['versal-vek280-sdt-seg' !='${MACHINE}']}"
#### Regular settings follow
TUNEFILE[microblaze-pmc] = "conf/machine/include/versal-vek280-sdt-seg/microblaze.inc"
TUNEFILE[microblaze-psm] = "conf/machine/include/versal-vek280-sdt-seg/microblaze.inc"

# Platform Loader and Manager
PLM_DEPENDS = ""
PLM_MCDEPENDS = "mc::versal-vek280-sdt-seg-microblaze-pmc:plm-firmware:do_deploy"
PLM_DEPLOY_DIR = "${TMPDIR}-versal-vek280-sdt-seg-microblaze-pmc/deploy/images/${MACHINE}"

# PSM Firware
PSM_DEPENDS = ""
PSM_MCDEPENDS = "mc::versal-vek280-sdt-seg-microblaze-psm:psm-firmware:do_deploy"
PSM_FIRMWARE_DEPLOY_DIR = "${TMPDIR}-versal-vek280-sdt-seg-microblaze-psm/deploy/images/${MACHINE}"

# Set the default (linux) domain device tree
CONFIG_DTFILE_DIR := "${@bb.utils.which(d.getVar('BBPATH'), 'conf/dts/versal-vek280-sdt-seg')}"
CONFIG_DTFILE ?= "${CONFIG_DTFILE_DIR}/cortexa72-linux.dts"
CONFIG_DTFILE[vardepsexclude] += "CONFIG_DTFILE_DIR"

# Yocto arm-trusted-firmware(TF-A) variables
TFA_CONSOLE ?= "pl011"
TFA_BL33_LOAD ?= "0x8000000"

# Set DDR Base address for u-boot-xlnx-scr variables
DDR_BASEADDR ?= "0x0"
SKIP_APPEND_BASEADDR ?= "0"

# Yocto KERNEL Variables
UBOOT_ENTRYPOINT  ?= "0x200000"
UBOOT_LOADADDRESS ?= "0x200000"

# Yocto MACHINE_FEATURES Variable
MACHINE_FEATURES += "vdu fpga-overlay"

# Required generic machine inclusion
require conf/machine/versal-generic.conf

# Enable meta-xilinx-imgrcvry if available
include conf/enable-xilinx-imgrcvry.conf
QB_MEM = "-m 12G"
QEMU_HW_DTB_PS = "${QEMU_HW_DTB_PATH}/board-versal-ps-vek280.dtb"
QEMU_HW_DTB_PMC = "${QEMU_HW_DTB_PATH}/board-versal-pmc-virt.dtb"
QEMU_HW_BOOT_MODE ?= "5"
QEMU_FLASH_TYPE ?= "ospi"
QEMU_HW_SD_FILE ?= "qemu-ospi-${MACHINE}.bin"
QB_OPT_APPEND:append := " -drive file=@DEPLOY_DIR_IMAGE@/${QEMU_HW_SD_FILE},if=mtd,format=raw,index=4"

# This is an 'SDT' based BSP
XILINX_WITH_ESW = "sdt"

# Original SDT artifacts URL
SDT_URI = "https://edf.amd.com/sswreleases/rel-v2025.2/sdt/2025.2/2025.2_1115_1_11150857/external/versal-vek280-sdt-seg/versal-vek280-sdt-seg_2025.2_1115_1_11150857.tar.gz"
SDT_URI[sha256sum] = "8fe923fb72bedadc7b48c6f974f9a26508919bb872acd8130cecf2eb93d3412c"
SDT_URI[S] = "${WORKDIR}/versal-vek280-sdt-seg_2025.2_1115_1_11150857"

# Set the system device trees
SYSTEM_DTFILE_DEPENDS = "sdt-artifacts"
SYSTEM_DTFILE_DIR = "${RECIPE_SYSROOT}${datadir}/sdt/${MACHINE}"
SYSTEM_DTFILE = "${SYSTEM_DTFILE_DIR}/system-top.dts"

# Load the dynamic machine features
include conf/machine/include/versal-vek280-sdt-seg/${BB_CURRENT_MC}-features.conf
LIBXIL_CONFIG = "conf/machine/include/versal-vek280-sdt-seg/${BB_CURRENT_MC}-libxil.conf"

# Versal PDI
PDI_PATH_DEPENDS = "sdt-artifacts"
PDI_PATH_DIR = "${RECIPE_SYSROOT}${datadir}/sdt/${MACHINE}"
PDI_PATH = "${PDI_PATH_DIR}/vek280_base_boot.pdi"

# Update bootbin to use proper device tree
BIF_PARTITION_IMAGE[device-tree] = "${RECIPE_SYSROOT}/boot/devicetree/${@os.path.basename(d.getVar('CONFIG_DTFILE').replace('.dts', '.dtb'))}"

# Remap boot files to ensure the right device tree is listed first
IMAGE_BOOT_FILES =+ "devicetree/${@os.path.basename(d.getVar('CONFIG_DTFILE').replace('.dts', '.dtb'))}"

#### No additional settings should be after the Postamble
#### Postamble
PACKAGE_EXTRA_ARCHS:append = "${@['', ' versal_vek280_sdt_seg']['versal-vek280-sdt-seg' != '${MACHINE}']}"
```
