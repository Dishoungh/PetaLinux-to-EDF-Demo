## Yocto/sources/meta-amd-adaptive-socs/meta-amd-adaptive-socs-bsp/conf/machine/zynq-zc702-sdt-full.conf
```bitbake
#@TYPE: Machine
#@NAME: zynq-zc702-sdt-full
#@DESCRIPTION: Machine configuration for the zynq-zc702-sdt-full boards.


BBMULTICONFIG += "zynq-zc702-sdt-full-cortexa9-fsbl"

#### Preamble
MACHINEOVERRIDES =. "${@['', 'zynq-zc702-sdt-full:']['zynq-zc702-sdt-full' !='${MACHINE}']}"
#### Regular settings follow

# First Stage Boot Loader
FSBL_DEPENDS = ""
FSBL_MCDEPENDS = "mc::zynq-zc702-sdt-full-cortexa9-fsbl:fsbl-firmware:do_deploy"
FSBL_DEPLOY_DIR = "${TMPDIR}-zynq-zc702-sdt-full-cortexa9-fsbl/deploy/images/${MACHINE}"

# Set the default (linux) domain device tree
CONFIG_DTFILE_DIR := "${@bb.utils.which(d.getVar('BBPATH'), 'conf/dts/zynq-zc702-sdt-full')}"
CONFIG_DTFILE ?= "${CONFIG_DTFILE_DIR}/cortexa9-linux.dts"
CONFIG_DTFILE[vardepsexclude] += "CONFIG_DTFILE_DIR"

# Set DDR Base address for u-boot-xlnx-scr variables
DDR_BASEADDR ?= "0x100000"
SKIP_APPEND_BASEADDR ?= "0"

# Yocto KERNEL Variables
UBOOT_ENTRYPOINT  ?= "0x300000"
UBOOT_LOADADDRESS ?= "0x300000"
KERNEL_EXTRA_ARGS += "UIMAGE_LOADADDR=${UBOOT_ENTRYPOINT}"

# Yocto MACHINE_FEATURES Variable
MACHINE_FEATURES += "fpga-overlay"

# Required generic machine inclusion
require conf/machine/zynq-generic.conf

QB_MEM = "-m 1024"
QEMU_HW_SERIAL = "-serial null -serial mon:stdio"

# This is an 'SDT' based BSP
XILINX_WITH_ESW = "sdt"

# Original SDT artifacts URL
SDT_URI = "https://edf.amd.com/sswreleases/rel-v2025.2/sdt/2025.2/2025.2_1115_1_11150857/external/zynq-zc702-sdt-full/zynq-zc702-sdt-full_2025.2_1115_1_11150857.tar.gz"
SDT_URI[sha256sum] = "2c817695d1b38fafff79cbbfc5dfc49eed6793ddb38ae63e28edc84f202efdb6"
SDT_URI[S] = "${WORKDIR}/zynq-zc702-sdt-full_2025.2_1115_1_11150857"

# Set the system device trees
SYSTEM_DTFILE_DEPENDS = "sdt-artifacts"
SYSTEM_DTFILE_DIR = "${RECIPE_SYSROOT}${datadir}/sdt/${MACHINE}"
SYSTEM_DTFILE = "${SYSTEM_DTFILE_DIR}/system-top.dts"

# Load the dynamic machine features
include conf/machine/include/zynq-zc702-sdt-full/${BB_CURRENT_MC}-features.conf
LIBXIL_CONFIG = "conf/machine/include/zynq-zc702-sdt-full/${BB_CURRENT_MC}-libxil.conf"

# Update bootbin to use proper device tree
BIF_PARTITION_IMAGE[device-tree] = "${RECIPE_SYSROOT}/boot/devicetree/${@os.path.basename(d.getVar('CONFIG_DTFILE').replace('.dts', '.dtb'))}"

# Remap boot files to ensure the right device tree is listed first
IMAGE_BOOT_FILES =+ "devicetree/${@os.path.basename(d.getVar('CONFIG_DTFILE').replace('.dts', '.dtb'))}"

#### No additional settings should be after the Postamble
#### Postamble
PACKAGE_EXTRA_ARCHS:append = "${@['', ' zynq_zc702_sdt_full']['zynq-zc702-sdt-full' != '${MACHINE}']}"
```

## Yocto/sources/meta-amd-adaptive-socs/meta-amd-adaptive-socs-bsp/conf/machine/zynqmp-zcu106-sdt-full.conf
```bitbake
#@TYPE: Machine
#@NAME: zynqmp-zcu106-sdt-full
#@DESCRIPTION: Machine configuration for the zynqmp-zcu106-sdt-full boards.


BBMULTICONFIG += "zynqmp-zcu106-sdt-full-cortexa53-fsbl zynqmp-zcu106-sdt-full-microblaze-pmu"

#### Preamble
MACHINEOVERRIDES =. "${@['', 'zynqmp-zcu106-sdt-full:']['zynqmp-zcu106-sdt-full' !='${MACHINE}']}"
#### Regular settings follow
TUNEFILE[microblaze-pmu] = "conf/machine/include/zynqmp-zcu106-sdt-full/microblaze.inc"

# First Stage Boot Loader
FSBL_DEPENDS = ""
FSBL_MCDEPENDS = "mc::zynqmp-zcu106-sdt-full-cortexa53-fsbl:fsbl-firmware:do_deploy"
FSBL_DEPLOY_DIR = "${TMPDIR}-zynqmp-zcu106-sdt-full-cortexa53-fsbl/deploy/images/${MACHINE}"

# PMU Firware
PMU_DEPENDS = ""
PMU_MCDEPENDS = "mc::zynqmp-zcu106-sdt-full-microblaze-pmu:pmu-firmware:do_deploy"
PMU_FIRMWARE_DEPLOY_DIR = "${TMPDIR}-zynqmp-zcu106-sdt-full-microblaze-pmu/deploy/images/${MACHINE}"

# Set the default (linux) domain device tree
CONFIG_DTFILE_DIR := "${@bb.utils.which(d.getVar('BBPATH'), 'conf/dts/zynqmp-zcu106-sdt-full')}"
CONFIG_DTFILE ?= "${CONFIG_DTFILE_DIR}/cortexa53-linux.dts"
CONFIG_DTFILE[vardepsexclude] += "CONFIG_DTFILE_DIR"

# Yocto arm-trusted-firmware(TF-A) variables
TFA_CONSOLE ?= "cadence"
TFA_BL33_LOAD ?= "0x8000000"

# Set DDR Base address for u-boot-xlnx-scr variables
DDR_BASEADDR ?= "0x0"
SKIP_APPEND_BASEADDR ?= "0"

# Yocto KERNEL Variables
UBOOT_ENTRYPOINT  ?= "0x200000"
UBOOT_LOADADDRESS ?= "0x200000"

# Yocto MACHINE_FEATURES Variable
MACHINE_FEATURES += "mali400 vcu fpga-overlay"

# Yocto IMAGE_FEATURES Variable
MACHINE_HWCODECS = "libvcu-omxil"
IMAGE_FEATURES += "hwcodecs"

# Required generic machine inclusion
require conf/machine/zynqmp-generic.conf

QB_MEM = "-m 4G"
QEMU_HW_DTB_PS = "${QEMU_HW_DTB_PATH}/board-zynqmp-zcu102.dtb"
QEMU_HW_DTB_PMU = "${QEMU_HW_DTB_PATH}/zynqmp-pmu.dtb"
# Temporarily enable XEN and XEN QEMU DTSI to system.dtb
ENABLE_XEN_DTSI = "1"
ENABLE_XEN_QEMU_DTSI = "1"

# This is an 'SDT' based BSP
XILINX_WITH_ESW = "sdt"

# Original SDT artifacts URL
SDT_URI = "https://edf.amd.com/sswreleases/rel-v2025.2/sdt/2025.2/2025.2_1115_1_11150857/external/zynqmp-zcu106-sdt-full/zynqmp-zcu106-sdt-full_2025.2_1115_1_11150857.tar.gz"
SDT_URI[sha256sum] = "1bb0549c50ff6a7877dbed6d15924993d171ab946ff4d75ba2ab26df74ff1472"
SDT_URI[S] = "${WORKDIR}/zynqmp-zcu106-sdt-full_2025.2_1115_1_11150857"

# Set the system device trees
SYSTEM_DTFILE_DEPENDS = "sdt-artifacts"
SYSTEM_DTFILE_DIR = "${RECIPE_SYSROOT}${datadir}/sdt/${MACHINE}"
SYSTEM_DTFILE = "${SYSTEM_DTFILE_DIR}/system-top.dts"

# Load the dynamic machine features
include conf/machine/include/zynqmp-zcu106-sdt-full/${BB_CURRENT_MC}-features.conf
LIBXIL_CONFIG = "conf/machine/include/zynqmp-zcu106-sdt-full/${BB_CURRENT_MC}-libxil.conf"

# Update bootbin to use proper device tree
BIF_PARTITION_IMAGE[device-tree] = "${RECIPE_SYSROOT}/boot/devicetree/${@os.path.basename(d.getVar('CONFIG_DTFILE').replace('.dts', '.dtb'))}"

# Remap boot files to ensure the right device tree is listed first
IMAGE_BOOT_FILES =+ "devicetree/${@os.path.basename(d.getVar('CONFIG_DTFILE').replace('.dts', '.dtb'))}"

#### No additional settings should be after the Postamble
#### Postamble
PACKAGE_EXTRA_ARCHS:append = "${@['', ' zynqmp_zcu106_sdt_full']['zynqmp-zcu106-sdt-full' != '${MACHINE}']}"
```

## Yocto/sources/meta-amd-edf/conf/distro/amd-edf.conf
```bitbake
require conf/distro/poky-altcfg.conf

include conf/distro/include/amd-edf-feed.conf

include conf/distro/include/amd-edf-mirrors.conf

# Because we are no longer strictly poky-altcfg, set distro variables

DISTRO = "amd-edf"
DISTRO_NAME = "AMD Embedded Development Framework Linux distribution"

# Define the default hostname
hostname:pn-base-files:amd-edf = "amd-edf"

# Based on poky-altcfg
DISTROOVERRIDES = "poky:poky-altcfg:amd-edf"

AMD-EDF_VERSION = "25.11"
AMD-EDF_MINOR = ""

# Set to "development" or "release" for release
AMD-EDF_VER_TYPE = "development"

# This will be set in local.conf for CI builds
AMD-EDF_VER_BUILD ?= "${@'${METADATA_REVISION}' if d.getVar('METADATA_REVISION') != '<unknown>' else 'unknown'}"

# Follow the Poky format of <Version>+<type>-<date>
DISTRO_VERSION = "${AMD-EDF_VERSION}${AMD-EDF_MINOR}+${AMD-EDF_VER_TYPE}-${AMD-EDF_VER_BUILD}"

SDK_VENDOR = "-amdedfsdk"

MAINTAINER = "AMD AECG <meta-xilinx@yoctoproject.org>"

TARGET_VENDOR = "-amd"

# Define the ROS2 Yocto release
ROS_OE_RELEASE_SERIES = "scarthgap"

# Define ROS2 distro release
ROS_DISTRO = "jazzy"

# While microblaze (classic) is not supported, we want to ensure it can
# be built if needed
POKY_INIT_MANAGER:amd-edf:microblaze = "sysvinit"
AMD-EDF_DISTRO_FEATURES:microblaze = ""

AMD-EDF_DISTRO_FEATURES = " \
    multiarch \
    security \
    virtualization \
    "

AMD-EDF_DISTRO_FEATURES:append:arm = " \
    vmsep \
    "

AMD-EDF_DISTRO_FEATURES:append:aarch64 = " \
    openamp \
    tpm \
    vmsep \
    xen \
    efi \
    polkit \
    rauc \
    "

DISTRO_FEATURES:append = " ${AMD-EDF_DISTRO_FEATURES}"

# Ensure rauc is enabled fully, this will require a temporary override and setting
SYSTEM_CONTROLLER_RAUC_DEMO = "yes"
DISTROOVERRIDES .= "${@ ':system-controller-rauc-demo' if bb.utils.to_boolean(d.getVar('SYSTEM_CONTROLLER_RAUC_DEMO'), False) else ''}"

# Set EFI_PROVIDER to systemd-boot for EDF by default
EFI_PROVIDER ?= "systemd-boot"

PREFERRED_RPROVIDER_virtual-systemd-bootconf = "systemd-bootconf-edf"

# The following really should not refer to MACHINE_FEATURES, but there isn't
# a better way at this point
DISTRO_FEATURES:append = "${@bb.utils.contains('MACHINE_FEATURES', 'mali400', ' libmali', '', d)}"
DISTRO_FEATURES:append = "${@bb.utils.contains('MACHINE_FEATURES', 'malig78ae', ' libmali', '', d)}"
DISTRO_FEATURES[vardepsexclude] += "MACHINE_FEATURES"

# Disable Busybox - Based on Poky example here:
# poky/meta-poky/conf/templates/default/local.conf.sample.extended

PREFERRED_PROVIDER_base-utils = "packagegroup-core-base-utils"
VIRTUAL-RUNTIME_base-utils = "packagegroup-core-base-utils"
VIRTUAL-RUNTIME_base-utils-hwclock = "util-linux-hwclock"
VIRTUAL-RUNTIME_base-utils-syslog = ""

# Enable license package generation
LICENSE_CREATE_PACKAGE = "1"

# Set start-jupyterlab as default start daemon.
PREFERRED_PROVIDER_start-jupyter = "start-jupyterlab"

# Boot script only required for Zynq, ZynqMP and Kria devices.
UBOOT_BOOT_SCRIPT_SOC_DEFAULT = ""
UBOOT_BOOT_SCRIPT_SOC_DEFAULT:zynq = "u-boot-edf-scr"
UBOOT_BOOT_SCRIPT_SOC_DEFAULT:zynqmp = "u-boot-edf-scr"
UBOOT_BOOT_SCRIPT_SOC_DEFAULT:kria:zynqmp = "u-boot-xlnx-scr"

# Allow this to be easily overridden by an image
UBOOT_BOOT_SCRIPT = "${UBOOT_BOOT_SCRIPT_SOC_DEFAULT}"

# Configure default users/groups
# Default rules (assumed no debug-tweaks image feature):
# * disabled root login (set by system default)
# * Add a user 'amd-edf' with no password
#   - SSH won't allow passwd-less login w/o debug tweaks, so requires console login
#   - Set to immediately expire
#   - Add to the sudoers file
# * Add 'amd-edf' user to the audio group
# * Add 'amd-edf' user to the video group
IMAGE_CLASSES += "extrausers"
EXTRA_USERS_PARAMS ?= "\
    useradd -p '' amd-edf;passwd-expire amd-edf; \
    groupadd -r aie; \
    groupadd -r wayland; \
    usermod -a -G aie,audio,input,video,wayland amd-edf; \
"
USERADDEXTENSION:append = " amd-useradd-sudoers"
EXTRA_USERS_SUDOERS ?= "amd-edf ALL=(ALL) ALL;"

# Disable OpenAMP device tree overlay package
ENABLE_OPENAMP_DTSI = "${@bb.utils.contains('DISTRO_FEATURES', 'openamp', '2', '0', d)}"
```

## Yocto/sources/meta-amd-edf/conf/distro/include/amd-edf-mirrors.conf
```bitbake
# QT code repository is often unavailable (503 or similar)
# Typically specified in meta-qt5/conf/layer.conf
QT_GIT ??= "git://code.qt.io/qt"
QT_MIRROR ?= "git://github.com/qt"
MIRRORS:append = " ${QT_GIT} ${QT_MIRROR}"
```

## Yocto/sources/meta-amd-edf/conf/layer.conf
```bitbake
# We have a conf and classes directory, add to BBPATH
BBPATH .= ":${LAYERDIR}"

# TO override a oe-core bbclass
BBPATH =. "${LAYERDIR}/oe-core/meta:"

# We have recipes-* directories, add to BBFILES
BBFILES += " \
    ${LAYERDIR}/recipes-*/*/*.bb \
    ${LAYERDIR}/recipes-*/*/*.bbappend \
    "

BBFILE_COLLECTIONS += "amd-edf"
BBFILE_PRIORITY_amd-edf = "5"
BBFILE_PATTERN_amd-edf = "^${LAYERDIR}/"
BBFILE_PATTERN_IGNORE_EMPTY_amd-edf = "1"

LAYERDEPENDS_amd-edf = "\
    core \
    xilinx \
    xilinx-standalone \
    xilinx-standalone-sdt \
    xilinx-microblaze \
    xilinx-demos \
    amd-adaptive-socs-core \
    amd-adaptive-socs-bsp \
    ros2-layer \
    ros2-jazzy-layer \
    openamp-layer \
    xilinx-virtualization \
    virtualization-layer \
    security \
    tpm-layer \
    qt5-layer \
    rauc \
    "

LAYERSERIES_COMPAT_amd-edf = "scarthgap"

LAYERBASE_amd-edf = "${LAYERDIR}"
AMD-EDF_OECORE = "${LAYERBASE_amd-edf}/oe-core"

BBFILES_DYNAMIC += " \
    xilinx-mali400:${LAYERDIR}/dynamic-layers/xilinx-mali400/recipes-*/*/*.bb \
    xilinx-mali400:${LAYERDIR}/dynamic-layers/xilinx-mali400/recipes-*/*/*.bbappend \
    meta-system-controller:${LAYERDIR}/dynamic-layers/meta-system-controller/recipes-*/*/*.bbappend \
    xilinx-virtualization:${LAYERDIR}/dynamic-layers/xilinx-virtualization/recipes-*/*/*.bbappend \
    "

# Disable some of the ros recipes which doesn't build.
BBMASK += " \
        meta-ros/meta-ros2-jazzy/generated-recipes/fuse/ \
        meta-ros/meta-ros2-jazzy/recipes-bbappends/fuse/ \
        meta-ros/meta-ros2-jazzy/recipes-support/fuse/ \
        meta-rauc/recipes-support/curl/ \
        meta-rauc/recipes-core/packagegroups/ \
        meta-system-controller/dynamic-layers/system-controller-rauc-demo/recipes-bsp/u-boot/u-boot-xlnx-scr.bbappend \
        "

USER_CLASSES += "amd-edf-check-image"
```

## Yocto/sources/meta-amd-edf/meta-amd-edf-bsp/conf/layer.conf
```bitbake
# We have a conf and classes directory, add to BBPATH
BBPATH .= ":${LAYERDIR}"

# We have recipes-* directories, add to BBFILES
BBFILES += " \
    ${LAYERDIR}/recipes-*/*/*.bb \
    ${LAYERDIR}/recipes-*/*/*.bbappend \
    "

BBFILE_COLLECTIONS += "amd-edf-bsp"
BBFILE_PRIORITY_amd-edf-bsp = "5"
BBFILE_PATTERN_amd-edf-bsp = "^${LAYERDIR}/"
BBFILE_PATTERN_IGNORE_EMPTY_amd-edf-bsp = "1"

LAYERDEPENDS_amd-edf-bsp = "\
    amd-edf \
    "

LAYERSERIES_COMPAT_amd-edf-bsp = "scarthgap"
```

## Yocto/sources/meta-amd-edf/meta-amd-edf-bsp/conf/machine/amd-cortexa78-mali-common.conf
```bitbake
#@TYPE: Machine
#@NAME: amd-cortexa78-mali-common
#@DESCRIPTION: Machine configuration for a common AMD filesystem for devices with cortexa78 and malig78

#### Preamble
MACHINEOVERRIDES =. "${@['', 'amd-cortexa78-mali-common:']['amd-cortexa78-mali-common' != '${MACHINE}']}"
#### Regular settings follow

DEFAULTTUNE = "cortexa72-cortexa53"

# These devices are all Versal Gen 2 related
require conf/machine/versal-2ve-2vm-generic.conf

# Clear the machine specifc settings
QB_CMDLINE_IP_SLIRP = ""
QB_CMDLINE_IP_TAP = ""
QB_DEFAULT_KERNEL = ""
QB_DTB = ""
QB_MACHINE = ""
QB_MEM = ""
QB_NETWORK_DEVICE = ""
QB_NO_PNI = ""
QB_OPT_APPEND = ""
QB_ROOTFS_OPT = ""
QB_SERIAL_OPT = ""

MACHINE_FEATURES += "vcu2 malig78ae fpga-overlay optee efi"

#### No additional settings should be after the Postamble
#### Postamble
PACKAGE_EXTRA_ARCHS:append = "${@['', ' amd_cortexa78_mali_common']['amd-cortexa78-mali-common' != "${MACHINE}"]}"
```

## Yocto/sources/meta-amd-edf/meta-amd-edf-bsp/conf/machine/amd-rv64imafdc-zicbom-zba-zbb-zbs-common.conf
```bitbake
#@TYPE: Machine
#@NAME: amd-rv64imafdc-zicbom-zba-zbb-zbs-common
#@DESCRIPTION: Machine configuration for a common AMD filesystem for devices with riscv 64 imafdc zicbom zicsr zifencei zba zbb zbs

#### Preamble
MACHINEOVERRIDES =. "${@['', 'amd-rv64imafdc-zicbom-zba-zbb-zbs-common:']['amd-rv64imafdc-zicbom-zba-zbb-zbs-common' != '${MACHINE}']}"
#### Regular settings follow

# Set the default for a modern full feature (32-bit) microblaze-v...
# Note, glibc does not support 'f' without 'd'
TUNE_FEATURES:tune-microblaze-v = "${@mbv.tune.riscv_isa_to_tune("rv64imafdc_zicbom_zicsr_zifencei_zba_zbb_zbs")}"

# These devices are all zynqmp related
require conf/machine/microblaze-v-generic.conf

# Clear the machine specifc settings
#QB_CMDLINE_IP_SLIRP = ""
#QB_CMDLINE_IP_TAP = ""
#QB_DEFAULT_KERNEL = ""
#QB_DTB = ""
#QB_MACHINE = ""
#QB_MEM = ""
#QB_NETWORK_DEVICE = ""
#QB_NO_PNI = ""
#QB_OPT_APPEND = ""
#QB_ROOTFS_OPT = ""
#QB_SERIAL_OPT = ""

# Might want to add EFI or fpga-overlay, TBD
MACHINE_FEATURES += ""

#### No additional settings should be after the Postamble
#### Postamble
PACKAGE_EXTRA_ARCHS:append = "${@['', ' amd_rv64imafdc_zicbom_zba_zbb_zbs_common']['amd-rv64imafdc-zicbom-zba-zbb-zbs-common' != "${MACHINE}"]}"
```
