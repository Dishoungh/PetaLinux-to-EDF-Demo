## Yocto/sources/meta-amd-edf/wic/edf-disk-single-rootfs-efi.wks
```
# Partitioned disk image for AMD Embedded Development Framework - EFI booted
# Based on a total disk size of 8GB
#
# layout:
#     /efi         1GB      - used for boot.bin and Arm SystemReady-compatible EFI firmware update capsules
#     storage      1GB      - user storage (no default mount)
#     /            6GB      - general-purpose, Yocto-built Linux user-space filesystem

part  /efi       --source bootimg-efi-amd --sourceparams="loader=${EFI_PROVIDER},rootfs_uuid=${ROOTFS_PART_UUID}" --fixed-size=1G  --align 16 --fstype=vfat  --use-label  --label esp  --active  --mbr  --use-uuid  --part-type="${ESP_PART_TYPE}"  --part-name="ESP"
part  storage                             --fixed-size=1G    --align 4  --fstype=vfat  --use-label  --label storage
part  /          --source rootfs          --fixed-size=6G    --align 4  --fstype=ext4  --use-label  --label root --uuid="${ROOTFS_PART_UUID}"  --use-uuid --part-type="${ROOTFS_PART_TYPE}"

bootloader --ptable gpt-hybrid
```

## Yocto/sources/meta-amd-edf/wic/edf-disk-single-rootfs.wks
```
# Partitioned disk image for AMD Embedded Development Framework
# Based on a total disk size of 8GB
#
# layout:
#     /boot/efi   512MB    - a place for BOOT.bin and Arm SystemReady-compatible EFI firmware update capsules
#     /boot       512MB    - traditional /boot (u-boot scripts, Linux kernel, device trees, etc)
#     /             6GB    - general-purpose, yocto-built Linux user-space filesystem
#     storage       1GB    - user storage

part  /boot/efi                                            --fixed-size=512M  --align 16 --fstype=vfat  --use-label  --label esp
part  /boot      --source rootfs  --change-directory=boot  --fixed-size=512M  --align 4  --fstype=ext4  --use-label  --label boot     --active
part  /          --source rootfs  --exclude-path=boot/     --fixed-size=6G    --align 4  --fstype=ext4  --use-label  --label root
part  storage                                              --fixed-size=1G    --align 4  --fstype=vfat  --use-label  --label storage

bootloader --ptable msdos
```

## Yocto/sources/meta-custom/conf/machine/include/zcu104/zcu104-cortexa53-fsbl-features.conf
```bitbake
MACHINE_FEATURES = "avbuf axipmon canps clockps common coresightps-dcc csudma ddrcpsu dpdma dppsu emacps gpio gpiops iicps ipipsu qspipsu resetps rtcpsu scugic sdps sysmonpsu ttcps uartps usbpsu video-common wdtps zdma"
```

## Yocto/sources/meta-custom/conf/machine/zcu104.conf
```bitbake
#@TYPE: Machine
#@NAME: zcu104
#@DESCRIPTION: Machine configuration for the zcu104 boards.


BBMULTICONFIG += "zcu104-cortexa53-fsbl zcu104-microblaze-pmu"

#### Preamble
MACHINEOVERRIDES =. "${@['', 'zcu104:']['zcu104' !='${MACHINE}']}"
#### Regular settings follow
TUNEFILE[microblaze-pmu] = "conf/machine/include/zcu104/microblaze.inc"

# First Stage Boot Loader
FSBL_DEPENDS = ""
FSBL_MCDEPENDS = "mc::zcu104-cortexa53-fsbl:fsbl-firmware:do_deploy"
FSBL_DEPLOY_DIR = "${TMPDIR}-zcu104-cortexa53-fsbl/deploy/images/${MACHINE}"

# PMU Firware
PMU_DEPENDS = ""
PMU_MCDEPENDS = "mc::zcu104-microblaze-pmu:pmu-firmware:do_deploy"
PMU_FIRMWARE_DEPLOY_DIR = "${TMPDIR}-zcu104-microblaze-pmu/deploy/images/${MACHINE}"

# Set the default (linux) domain device tree
CONFIG_DTFILE_DIR := "${@bb.utils.which(d.getVar('BBPATH'), 'conf/dts/zcu104')}"
CONFIG_DTFILE ?= "${CONFIG_DTFILE_DIR}/cortexa53-linux.dts"
CONFIG_DTFILE[vardepsexclude] += "CONFIG_DTFILE_DIR"

# Yocto arm-trusted-firmware(TF-A) variables
TFA_CONSOLE ?= "cadence"
TFA_BL33_LOAD ?= "0x8000000"

# Set DDR Base address for u-boot-xlnx-scr variables
DDR_BASEADDR ?= "0x0"
SKIP_APPEND_BASEADDR ?= "0"

# Yocto KERNEL Variables
UBOOT_ENTRYPOINT  ?= "0x200000"
UBOOT_LOADADDRESS ?= "0x200000"

# Yocto MACHINE_FEATURES Variable
MACHINE_FEATURES += "mali400 vcu"

# Yocto IMAGE_FEATURES Variable
MACHINE_HWCODECS = "libvcu-omxil"
IMAGE_FEATURES += "hwcodecs"

# Required generic machine inclusion
require conf/machine/zynqmp-generic.conf

# This is an 'SDT' based BSP
XILINX_WITH_ESW = "sdt"

# Original SDT artifacts URL
SDT_URI = "file:///home/lanza/workspace/PetaLinux-to-EDF-Demo/SDT"
SDT_URI[S] = "${WORKDIR}/home/lanza/workspace/PetaLinux-to-EDF-Demo/SDT"

# Set the system device trees
SYSTEM_DTFILE_DEPENDS = "sdt-artifacts"
SYSTEM_DTFILE_DIR = "${RECIPE_SYSROOT}${datadir}/sdt/${MACHINE}"
SYSTEM_DTFILE = "${SYSTEM_DTFILE_DIR}/system-top.dts"

# Load the dynamic machine features
include conf/machine/include/zcu104/${BB_CURRENT_MC}-features.conf
LIBXIL_CONFIG = "conf/machine/include/zcu104/${BB_CURRENT_MC}-libxil.conf"

# zynqmp bitstream path 
BITSTREAM_PATH_DEPENDS = "sdt-artifacts"
BITSTREAM_PATH_DIR = "${RECIPE_SYSROOT}${datadir}/sdt/${MACHINE}"
BITSTREAM_PATH = "${BITSTREAM_PATH_DIR}/Simple.bit"

# Update bootbin to use proper device tree
BIF_PARTITION_IMAGE[device-tree] = "${RECIPE_SYSROOT}/boot/devicetree/${@os.path.basename(d.getVar('CONFIG_DTFILE').replace('.dts', '.dtb'))}"

# Remap boot files to ensure the right device tree is listed first
IMAGE_BOOT_FILES =+ "devicetree/${@os.path.basename(d.getVar('CONFIG_DTFILE').replace('.dts', '.dtb'))}"

#### No additional settings should be after the Postamble
#### Postamble
PACKAGE_EXTRA_ARCHS:append = "${@['', ' zcu104']['zcu104' != '${MACHINE}']}"
```

## Yocto/sources/meta-system-controller/conf/layer.conf
```bitbake
# We have a conf and classes directory, add to BBPATH
BBPATH .= ":${LAYERDIR}"

# We have recipes-* directories, add to BBFILES
BBFILES += "${LAYERDIR}/recipes-*/*/*.bb \
            ${LAYERDIR}/recipes-*/*/*.bbappend"

BBPATH .= ":${LAYERDIR}/meta-xilinx-tools"

BBFILES_DYNAMIC += " \
	petalinux:${LAYERDIR}/dynamic-layers/meta-petalinux/recipes-*/*/*.bb \
	petalinux:${LAYERDIR}/dynamic-layers/meta-petalinux/recipes-*/*/*.bbappend \
	xilinx-tools:${LAYERDIR}/dynamic-layers/meta-xilinx-tools/recipes-*/*/*.bb \
	xilinx-tools:${LAYERDIR}/dynamic-layers/meta-xilinx-tools/recipes-*/*/*.bbappend \
	rauc:${LAYERDIR}/dynamic-layers/system-controller-rauc-demo/recipes-*/*/*.bb \
	rauc:${LAYERDIR}/dynamic-layers/system-controller-rauc-demo/recipes-*/*/*.bbappend \
	meta-python:${LAYERDIR}/dynamic-layers/meta-python/recipes-*/*/*.bb \
	meta-python:${LAYERDIR}/dynamic-layers/meta-python/recipes-*/*/*.bbappend \
	amd-edf:${LAYERDIR}/dynamic-layers/meta-amd-edf/recipes-*/*/*.bb \
	amd-edf:${LAYERDIR}/dynamic-layers/meta-amd-edf/recipes-*/*/*.bbappend \
	meta-xilinx-imgrcry:${LAYERDIR}/dynamic-layers/meta-xilinx-imgrcvry/recipes-*/*/*.bb \
	meta-xilinx-imgrcry:${LAYERDIR}/dynamic-layers/meta-xilinx-imgrcvry/recipes-*/*/*.bbappend \
        xilinx-standalone-sdt:${LAYERDIR}/dynamic-layers/meta-xilinx-standalone-sdt/recipes-*/*/*.bbappend \
	"

BBFILE_COLLECTIONS += "meta-system-controller"
BBFILE_PATTERN_meta-system-controller = "^${LAYERDIR}/"
BBFILE_PRIORITY_meta-system-controller = "6"

LAYERDEPENDS_meta-system-controller = "core xilinx webserver rauc"

LAYERRECOMMENDS_meta-system-controller = "xilinx-tools"

LAYERSERIES_COMPAT_meta-system-controller = "scarthgap"
```

## Yocto/sources/meta-system-controller/conf/machine/eval-brd-sc-zynqmp.conf
```bitbake
#@TYPE: Machine
#@NAME: eval-brd-sc-zynqmp
#@DESCRIPTION: Machine configuration for vkp120, vckp180, vhk158, vek280 system controller.


#### Preamble
MACHINEOVERRIDES =. "${@['', 'eval-brd-sc-zynqmp:']['eval-brd-sc-zynqmp' !='${MACHINE}']}"
#### Regular settings follow

# Yocto device-tree variables
YAML_CONSOLE_DEVICE_CONFIG:pn-device-tree ?= "psu_uart_1"
YAML_MAIN_MEMORY_CONFIG:pn-device-tree ?= "psu_ddr_0"
DT_PADDING_SIZE:pn-device-tree ?= "0x1000"
DTC_FLAGS:pn-device-tree ?= ""
YAML_DT_BOARD_FLAGS ?= "{BOARD zynqmp-sc-revb}"

# Yocto u-boot-xlnx variables
UBOOT_MACHINE ?= "xilinx_zynqmp_virt_defconfig"

# Yocto PMUFW variables
YAML_COMPILER_FLAGS:append:pn-pmu-firmware = " "
YAML_SERIAL_CONSOLE_STDIN:pn-pmu-firmware ?= "psu_uart_1"
YAML_SERIAL_CONSOLE_STDOUT:pn-pmu-firmware ?= "psu_uart_1"

# Yocto FSBL variables
YAML_SERIAL_CONSOLE_STDIN:pn-fsbl-firmware ?= "psu_uart_1"
YAML_SERIAL_CONSOLE_STDOUT:pn-fsbl-firmware ?= "psu_uart_1"

# Serial Console Settings
SERIAL_CONSOLES ?= "115200;ttyPS0"
YAML_SERIAL_CONSOLE_BAUDRATE ?= "115200"

# Yocto arm-trusted-firmware(TF-A) variables
TFA_CONSOLE ?= "cadence"
TFA_BL33_LOAD ?= "0x8000000"

# Set DDR Base address for u-boot-xlnx-scr variables
DDR_BASEADDR ?= "0x0"
SKIP_APPEND_BASEADDR ?= "0"

# Yocto KERNEL Variables
UBOOT_ENTRYPOINT  ?= "0x200000"
UBOOT_LOADADDRESS ?= "0x200000"

# Yocto MACHINE_FEATURES Variable
MACHINE_FEATURES += "mali400 fpga-overlay"

# Yocto uboot device-tree variables
YAML_CONSOLE_DEVICE_CONFIG:pn-uboot-device-tree ?= "psu_uart_1"

# Required generic machine inclusion
require conf/machine/system-controller-generic.conf

# Add the following files to /boot
IMAGE_BOOT_FILES += "system-sc-revc-zynqmp.dtb system.dtb"
WKS_FILES = "system-controller-nobootpartition.wks"

# enable RAUC_DEMO for this board by default
SYSTEM_CONTROLLER_RAUC_DEMO = "yes"

# This is an 'XSCT' based BSP
XILINX_XSCT_VERSION = "2025.2"
XILINX_WITH_ESW = "xsct"

# Add system XSA
HDF_URI = "https://petalinux.xilinx.com/sswreleases/rel-v2025.2/hdf-examples/2025.2/2025.2_0922_1_09230113/external/eval-brd-sc/eval-brd-sc-2025.2_0908_1.xsa"
HDF_URI[sha256sum] = "c62e26a9d4845c25febaf50ca53d3e0ca71d1e0e059bc9a0ebae83e2ca2f0e38"

#### No additional settings should be after the Postamble
#### Postamble
PACKAGE_EXTRA_ARCHS:append = "${@['', ' eval_brd_sc_zynqmp']['eval-brd-sc-zynqmp' != '${MACHINE}']}"
```

## Yocto/sources/meta-system-controller/conf/machine/include/zynqmp-k24-sc-sdt-base/zynqmp-k24-sc-sdt-base-cortexa53-fsbl-features.conf
```bitbake
MACHINE_FEATURES = "axipmon clockps common coresightps-dcc csudma ddrcpsu emacps gpiops iicps ipipsu qspipsu resetps rtcpsu scugic sdps spips sysmonpsu ttcps uartps usbpsu wdtps zdma"
```
